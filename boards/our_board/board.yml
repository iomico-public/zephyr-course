## twister-out/native_sim_native/host_gnu/applications/zephyr-course/tests/ring_buf/homework.unit.ring_buf/Kconfig/soc/Kconfig.defconfig.tmp
```kconfig
# Load Zephyr SoC defconfig descriptions.
osource "/home/lorsi/zephyrproject/deps/zephyr/soc/xlnx/zynqmp/Kconfig.defconfig"
osource "/home/lorsi/zephyrproject/deps/zephyr/soc/xlnx/zynq7000/Kconfig.defconfig"
osource "/home/lorsi/zephyrproject/deps/zephyr/soc/xlnx/versalnet/Kconfig.defconfig"
osource "/home/lorsi/zephyrproject/deps/zephyr/soc/xlnx/versal2/Kconfig.defconfig"
osource "/home/lorsi/zephyrproject/deps/zephyr/soc/xlnx/versal/Kconfig.defconfig"
osource "/home/lorsi/zephyrproject/deps/zephyr/soc/xen/Kconfig.defconfig"
osource "/home/lorsi/zephyrproject/deps/zephyr/soc/wch/ch32v/Kconfig.defconfig"
osource "/home/lorsi/zephyrproject/deps/zephyr/soc/ti/simplelink/Kconfig.defconfig"
osource "/home/lorsi/zephyrproject/deps/zephyr/soc/ti/mspm0/Kconfig.defconfig"
osource "/home/lorsi/zephyrproject/deps/zephyr/soc/ti/lm3s6965/Kconfig.defconfig"
osource "/home/lorsi/zephyrproject/deps/zephyr/soc/ti/k3/Kconfig.defconfig"
osource "/home/lorsi/zephyrproject/deps/zephyr/soc/telink/tlsr/Kconfig.defconfig"
osource "/home/lorsi/zephyrproject/deps/zephyr/soc/syna/sr100/Kconfig.defconfig"
osource "/home/lorsi/zephyrproject/deps/zephyr/soc/starfive/jh71xx/Kconfig.defconfig"
osource "/home/lorsi/zephyrproject/deps/zephyr/soc/st/stm32/Kconfig.defconfig"
osource "/home/lorsi/zephyrproject/deps/zephyr/soc/snps/qemu_arc/Kconfig.defconfig"
osource "/home/lorsi/zephyrproject/deps/zephyr/soc/snps/nsim/arc_v/Kconfig.defconfig"
osource "/home/lorsi/zephyrproject/deps/zephyr/soc/snps/nsim/arc_classic/Kconfig.defconfig"
osource "/home/lorsi/zephyrproject/deps/zephyr/soc/snps/hsdk4xd/Kconfig.defconfig"
osource "/home/lorsi/zephyrproject/deps/zephyr/soc/snps/hsdk/Kconfig.defconfig"
osource "/home/lorsi/zephyrproject/deps/zephyr/soc/snps/emsk/Kconfig.defconfig"
osource "/home/lorsi/zephyrproject/deps/zephyr/soc/snps/emsdp/Kconfig.defconfig"
osource "/home/lorsi/zephyrproject/deps/zephyr/soc/snps/arc_iot/Kconfig.defconfig"
osource "/home/lorsi/zephyrproject/deps/zephyr/soc/silabs/Kconfig.defconfig"
osource "/home/lorsi/zephyrproject/deps/zephyr/soc/sifli/sf32/Kconfig.defconfig"
osource "/home/lorsi/zephyrproject/deps/zephyr/soc/sifive/sifive_freedom/Kconfig.defconfig"
osource "/home/lorsi/zephyrproject/deps/zephyr/soc/sensry/Kconfig.defconfig"
osource "/home/lorsi/zephyrproject/deps/zephyr/soc/rockchip/Kconfig.defconfig"
osource "/home/lorsi/zephyrproject/deps/zephyr/soc/renode/riscv_virtual/Kconfig.defconfig"
osource "/home/lorsi/zephyrproject/deps/zephyr/soc/renode/cortex_r8_virtual/Kconfig.defconfig"
osource "/home/lorsi/zephyrproject/deps/zephyr/soc/renesas/smartbond/Kconfig.defconfig"
osource "/home/lorsi/zephyrproject/deps/zephyr/soc/renesas/rz/Kconfig.defconfig"
osource "/home/lorsi/zephyrproject/deps/zephyr/soc/renesas/rx/Kconfig.defconfig"
osource "/home/lorsi/zephyrproject/deps/zephyr/soc/renesas/rcar/Kconfig.defconfig"
osource "/home/lorsi/zephyrproject/deps/zephyr/soc/renesas/ra/Kconfig.defconfig"
osource "/home/lorsi/zephyrproject/deps/zephyr/soc/realtek/fingerprint/Kconfig.defconfig"
osource "/home/lorsi/zephyrproject/deps/zephyr/soc/realtek/ec/Kconfig.defconfig"
osource "/home/lorsi/zephyrproject/deps/zephyr/soc/realtek/bee/Kconfig.defconfig"
osource "/home/lorsi/zephyrproject/deps/zephyr/soc/realtek/ameba/Kconfig.defconfig"
osource "/home/lorsi/zephyrproject/deps/zephyr/soc/raspberrypi/rpi_pico/Kconfig.defconfig"
osource "/home/lorsi/zephyrproject/deps/zephyr/soc/quicklogic/eos_s3/Kconfig.defconfig"
osource "/home/lorsi/zephyrproject/deps/zephyr/soc/qemu/virt_riscv/Kconfig.defconfig"
osource "/home/lorsi/zephyrproject/deps/zephyr/soc/qemu/or1k/Kconfig.defconfig"
osource "/home/lorsi/zephyrproject/deps/zephyr/soc/qemu/malta/Kconfig.defconfig"
osource "/home/lorsi/zephyrproject/deps/zephyr/soc/openisa/rv32m1/Kconfig.defconfig"
osource "/home/lorsi/zephyrproject/deps/zephyr/soc/openhwgroup/cva6/Kconfig.defconfig"
osource "/home/lorsi/zephyrproject/deps/zephyr/soc/oct/osd32mp15x/Kconfig.defconfig"
osource "/home/lorsi/zephyrproject/deps/zephyr/soc/nxp/s32/Kconfig.defconfig"
osource "/home/lorsi/zephyrproject/deps/zephyr/soc/nxp/rw/Kconfig.defconfig"
osource "/home/lorsi/zephyrproject/deps/zephyr/soc/nxp/mcx/Kconfig.defconfig"
osource "/home/lorsi/zephyrproject/deps/zephyr/soc/nxp/lpc/Kconfig.defconfig"
osource "/home/lorsi/zephyrproject/deps/zephyr/soc/nxp/layerscape/Kconfig.defconfig"
osource "/home/lorsi/zephyrproject/deps/zephyr/soc/nxp/kinetis/Kconfig.defconfig"
osource "/home/lorsi/zephyrproject/deps/zephyr/soc/nxp/imxrt/Kconfig.defconfig"
osource "/home/lorsi/zephyrproject/deps/zephyr/soc/nxp/imx/Kconfig.defconfig"
osource "/home/lorsi/zephyrproject/deps/zephyr/soc/nuvoton/numicro/Kconfig.defconfig"
osource "/home/lorsi/zephyrproject/deps/zephyr/soc/nuvoton/numaker/Kconfig.defconfig"
osource "/home/lorsi/zephyrproject/deps/zephyr/soc/nuvoton/npcx/Kconfig.defconfig"
osource "/home/lorsi/zephyrproject/deps/zephyr/soc/nuvoton/npcm/Kconfig.defconfig"
osource "/home/lorsi/zephyrproject/deps/zephyr/soc/nordic/Kconfig.defconfig"
osource "/home/lorsi/zephyrproject/deps/zephyr/soc/neorv32/Kconfig.defconfig"
osource "/home/lorsi/zephyrproject/deps/zephyr/soc/native/inf_clock/Kconfig.defconfig"
osource "/home/lorsi/zephyrproject/deps/zephyr/soc/microchip/sam/sama7/Kconfig.defconfig"
osource "/home/lorsi/zephyrproject/deps/zephyr/soc/microchip/sam/sam_d5x_e5x/Kconfig.defconfig"
osource "/home/lorsi/zephyrproject/deps/zephyr/soc/microchip/pic64/Kconfig.defconfig"
osource "/home/lorsi/zephyrproject/deps/zephyr/soc/microchip/pic32c/pic32cz_ca/Kconfig.defconfig"
osource "/home/lorsi/zephyrproject/deps/zephyr/soc/microchip/pic32c/pic32cx_sg/Kconfig.defconfig"
osource "/home/lorsi/zephyrproject/deps/zephyr/soc/microchip/pic32c/pic32cm_pl/Kconfig.defconfig"
osource "/home/lorsi/zephyrproject/deps/zephyr/soc/microchip/pic32c/pic32cm_jh/Kconfig.defconfig"
osource "/home/lorsi/zephyrproject/deps/zephyr/soc/microchip/miv/Kconfig.defconfig"
osource "/home/lorsi/zephyrproject/deps/zephyr/soc/microchip/mec/Kconfig.defconfig"
osource "/home/lorsi/zephyrproject/deps/zephyr/soc/mediatek/mt8xxx/Kconfig.defconfig"
osource "/home/lorsi/zephyrproject/deps/zephyr/soc/lowrisc/opentitan/Kconfig.defconfig"
osource "/home/lorsi/zephyrproject/deps/zephyr/soc/litex/litex_vexriscv/Kconfig.defconfig"
osource "/home/lorsi/zephyrproject/deps/zephyr/soc/ite/ec/Kconfig.defconfig"
osource "/home/lorsi/zephyrproject/deps/zephyr/soc/intel/wildcat_lake/Kconfig.defconfig"
osource "/home/lorsi/zephyrproject/deps/zephyr/soc/intel/raptor_lake/Kconfig.defconfig"
osource "/home/lorsi/zephyrproject/deps/zephyr/soc/intel/panther_lake/Kconfig.defconfig"
osource "/home/lorsi/zephyrproject/deps/zephyr/soc/intel/lakemont/Kconfig.defconfig"
osource "/home/lorsi/zephyrproject/deps/zephyr/soc/intel/intel_socfpga_std/Kconfig.defconfig"
osource "/home/lorsi/zephyrproject/deps/zephyr/soc/intel/intel_socfpga/Kconfig.defconfig"
osource "/home/lorsi/zephyrproject/deps/zephyr/soc/intel/intel_niosv/Kconfig.defconfig"
osource "/home/lorsi/zephyrproject/deps/zephyr/soc/intel/intel_ish/Kconfig.defconfig"
osource "/home/lorsi/zephyrproject/deps/zephyr/soc/intel/intel_adsp/Kconfig.defconfig"
osource "/home/lorsi/zephyrproject/deps/zephyr/soc/intel/elkhart_lake/Kconfig.defconfig"
osource "/home/lorsi/zephyrproject/deps/zephyr/soc/intel/atom/Kconfig.defconfig"
osource "/home/lorsi/zephyrproject/deps/zephyr/soc/intel/apollo_lake/Kconfig.defconfig"
osource "/home/lorsi/zephyrproject/deps/zephyr/soc/intel/alder_lake/Kconfig.defconfig"
osource "/home/lorsi/zephyrproject/deps/zephyr/soc/infineon/psoc4/Kconfig.defconfig"
osource "/home/lorsi/zephyrproject/deps/zephyr/soc/infineon/edge/Kconfig.defconfig"
osource "/home/lorsi/zephyrproject/deps/zephyr/soc/infineon/cat3/Kconfig.defconfig"
osource "/home/lorsi/zephyrproject/deps/zephyr/soc/infineon/cat1c/Kconfig.defconfig"
osource "/home/lorsi/zephyrproject/deps/zephyr/soc/infineon/cat1b/Kconfig.defconfig"
osource "/home/lorsi/zephyrproject/deps/zephyr/soc/infineon/cat1a/Kconfig.defconfig"
osource "/home/lorsi/zephyrproject/deps/zephyr/soc/gd/gd32/Kconfig.defconfig"
osource "/home/lorsi/zephyrproject/deps/zephyr/soc/gaisler/leon3/Kconfig.defconfig"
osource "/home/lorsi/zephyrproject/deps/zephyr/soc/gaisler/gr716a/Kconfig.defconfig"
osource "/home/lorsi/zephyrproject/deps/zephyr/soc/focaltech/Kconfig.defconfig"
osource "/home/lorsi/zephyrproject/deps/zephyr/soc/espressif/Kconfig.defconfig"
osource "/home/lorsi/zephyrproject/deps/zephyr/soc/ene/kb1200/Kconfig.defconfig"
osource "/home/lorsi/zephyrproject/deps/zephyr/soc/ene/kb106x/Kconfig.defconfig"
osource "/home/lorsi/zephyrproject/deps/zephyr/soc/elan/em32f967/Kconfig.defconfig"
osource "/home/lorsi/zephyrproject/deps/zephyr/soc/egis/Kconfig.defconfig"
osource "/home/lorsi/zephyrproject/deps/zephyr/soc/efinix/sapphire/Kconfig.defconfig"
osource "/home/lorsi/zephyrproject/deps/zephyr/soc/cdns/xtensa_sample_controller/Kconfig.defconfig"
osource "/home/lorsi/zephyrproject/deps/zephyr/soc/cdns/swerv/Kconfig.defconfig"
osource "/home/lorsi/zephyrproject/deps/zephyr/soc/cdns/sample_controller32/Kconfig.defconfig"
osource "/home/lorsi/zephyrproject/deps/zephyr/soc/cdns/dc233c/Kconfig.defconfig"
osource "/home/lorsi/zephyrproject/deps/zephyr/soc/brcm/bcmvk/Kconfig.defconfig"
osource "/home/lorsi/zephyrproject/deps/zephyr/soc/brcm/bcm2712/Kconfig.defconfig"
osource "/home/lorsi/zephyrproject/deps/zephyr/soc/brcm/bcm2711/Kconfig.defconfig"
osource "/home/lorsi/zephyrproject/deps/zephyr/soc/blackberry/qnxhv_vm/Kconfig.defconfig"
osource "/home/lorsi/zephyrproject/deps/zephyr/soc/bflb/Kconfig.defconfig"
osource "/home/lorsi/zephyrproject/deps/zephyr/soc/atmel/sam0/Kconfig.defconfig"
osource "/home/lorsi/zephyrproject/deps/zephyr/soc/atmel/sam/Kconfig.defconfig"
osource "/home/lorsi/zephyrproject/deps/zephyr/soc/aspeed/Kconfig.defconfig"
osource "/home/lorsi/zephyrproject/deps/zephyr/soc/arm/Kconfig.defconfig"
osource "/home/lorsi/zephyrproject/deps/zephyr/soc/arm/beetle/Kconfig.defconfig"
osource "/home/lorsi/zephyrproject/deps/zephyr/soc/antmicro/myra/Kconfig.defconfig"
osource "/home/lorsi/zephyrproject/deps/zephyr/soc/andestech/Kconfig.defconfig"
osource "/home/lorsi/zephyrproject/deps/zephyr/soc/amd/acp_6_0/Kconfig.defconfig"
osource "/home/lorsi/zephyrproject/deps/zephyr/soc/ambiq/Kconfig.defconfig"
osource "/home/lorsi/zephyrproject/deps/zephyr/soc/allwinner/sun8i_h3/Kconfig.defconfig"
osource "/home/lorsi/zephyrproject/deps/zephyr/soc/alif/ensemble/Kconfig.defconfig"
osource "/home/lorsi/zephyrproject/deps/zephyr/soc/aesc/Kconfig.defconfig"
osource "/home/lorsi/zephyrproject/deps/zephyr/soc/adi/max32/Kconfig.defconfig"
```
