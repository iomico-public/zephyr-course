## l4-task1/l4_build/Kconfig/soc/Kconfig.soc.tmp
```kconfig
# Load SoC Kconfig descriptions.
osource "/home/enovo/zephyrproject/zephyr/soc/xlnx/zynqmp/Kconfig.soc"
osource "/home/enovo/zephyrproject/zephyr/soc/xlnx/zynq7000/Kconfig.soc"
osource "/home/enovo/zephyrproject/zephyr/soc/xlnx/versalnet/Kconfig.soc"
osource "/home/enovo/zephyrproject/zephyr/soc/xlnx/versal2/Kconfig.soc"
osource "/home/enovo/zephyrproject/zephyr/soc/xlnx/versal/Kconfig.soc"
osource "/home/enovo/zephyrproject/zephyr/soc/xen/Kconfig.soc"
osource "/home/enovo/zephyrproject/zephyr/soc/wch/ch32v/Kconfig.soc"
osource "/home/enovo/zephyrproject/zephyr/soc/ti/simplelink/Kconfig.soc"
osource "/home/enovo/zephyrproject/zephyr/soc/ti/mspm0/Kconfig.soc"
osource "/home/enovo/zephyrproject/zephyr/soc/ti/lm3s6965/Kconfig.soc"
osource "/home/enovo/zephyrproject/zephyr/soc/ti/k3/Kconfig.soc"
osource "/home/enovo/zephyrproject/zephyr/soc/telink/tlsr/Kconfig.soc"
osource "/home/enovo/zephyrproject/zephyr/soc/starfive/jh71xx/Kconfig.soc"
osource "/home/enovo/zephyrproject/zephyr/soc/st/stm32/Kconfig.soc"
osource "/home/enovo/zephyrproject/zephyr/soc/snps/qemu_arc/Kconfig.soc"
osource "/home/enovo/zephyrproject/zephyr/soc/snps/nsim/arc_v/Kconfig.soc"
osource "/home/enovo/zephyrproject/zephyr/soc/snps/nsim/arc_classic/Kconfig.soc"
osource "/home/enovo/zephyrproject/zephyr/soc/snps/hsdk4xd/Kconfig.soc"
osource "/home/enovo/zephyrproject/zephyr/soc/snps/hsdk/Kconfig.soc"
osource "/home/enovo/zephyrproject/zephyr/soc/snps/emsk/Kconfig.soc"
osource "/home/enovo/zephyrproject/zephyr/soc/snps/emsdp/Kconfig.soc"
osource "/home/enovo/zephyrproject/zephyr/soc/snps/arc_iot/Kconfig.soc"
osource "/home/enovo/zephyrproject/zephyr/soc/silabs/Kconfig.soc"
osource "/home/enovo/zephyrproject/zephyr/soc/sifli/sf32/Kconfig.soc"
osource "/home/enovo/zephyrproject/zephyr/soc/sifive/sifive_freedom/Kconfig.soc"
osource "/home/enovo/zephyrproject/zephyr/soc/sensry/Kconfig.soc"
osource "/home/enovo/zephyrproject/zephyr/soc/rockchip/Kconfig.soc"
osource "/home/enovo/zephyrproject/zephyr/soc/renode/riscv_virtual/Kconfig.soc"
osource "/home/enovo/zephyrproject/zephyr/soc/renode/cortex_r8_virtual/Kconfig.soc"
osource "/home/enovo/zephyrproject/zephyr/soc/renesas/smartbond/Kconfig.soc"
osource "/home/enovo/zephyrproject/zephyr/soc/renesas/rz/Kconfig.soc"
osource "/home/enovo/zephyrproject/zephyr/soc/renesas/rx/Kconfig.soc"
osource "/home/enovo/zephyrproject/zephyr/soc/renesas/rcar/Kconfig.soc"
osource "/home/enovo/zephyrproject/zephyr/soc/renesas/ra/Kconfig.soc"
osource "/home/enovo/zephyrproject/zephyr/soc/realtek/fingerprint/Kconfig.soc"
osource "/home/enovo/zephyrproject/zephyr/soc/realtek/ec/Kconfig.soc"
osource "/home/enovo/zephyrproject/zephyr/soc/realtek/bee/Kconfig.soc"
osource "/home/enovo/zephyrproject/zephyr/soc/realtek/ameba/Kconfig.soc"
osource "/home/enovo/zephyrproject/zephyr/soc/raspberrypi/rpi_pico/Kconfig.soc"
osource "/home/enovo/zephyrproject/zephyr/soc/quicklogic/eos_s3/Kconfig.soc"
osource "/home/enovo/zephyrproject/zephyr/soc/qemu/virt_riscv/Kconfig.soc"
osource "/home/enovo/zephyrproject/zephyr/soc/qemu/or1k/Kconfig.soc"
osource "/home/enovo/zephyrproject/zephyr/soc/qemu/malta/Kconfig.soc"
osource "/home/enovo/zephyrproject/zephyr/soc/openisa/rv32m1/Kconfig.soc"
osource "/home/enovo/zephyrproject/zephyr/soc/openhwgroup/cva6/Kconfig.soc"
osource "/home/enovo/zephyrproject/zephyr/soc/oct/osd32mp15x/Kconfig.soc"
osource "/home/enovo/zephyrproject/zephyr/soc/nxp/s32/Kconfig.soc"
osource "/home/enovo/zephyrproject/zephyr/soc/nxp/rw/Kconfig.soc"
osource "/home/enovo/zephyrproject/zephyr/soc/nxp/mcx/Kconfig.soc"
osource "/home/enovo/zephyrproject/zephyr/soc/nxp/lpc/Kconfig.soc"
osource "/home/enovo/zephyrproject/zephyr/soc/nxp/layerscape/Kconfig.soc"
osource "/home/enovo/zephyrproject/zephyr/soc/nxp/kinetis/Kconfig.soc"
osource "/home/enovo/zephyrproject/zephyr/soc/nxp/imxrt/Kconfig.soc"
osource "/home/enovo/zephyrproject/zephyr/soc/nxp/imx/Kconfig.soc"
osource "/home/enovo/zephyrproject/zephyr/soc/nuvoton/numicro/Kconfig.soc"
osource "/home/enovo/zephyrproject/zephyr/soc/nuvoton/numaker/Kconfig.soc"
osource "/home/enovo/zephyrproject/zephyr/soc/nuvoton/npcx/Kconfig.soc"
osource "/home/enovo/zephyrproject/zephyr/soc/nuvoton/npcm/Kconfig.soc"
osource "/home/enovo/zephyrproject/zephyr/soc/nordic/Kconfig.soc"
osource "/home/enovo/zephyrproject/zephyr/soc/neorv32/Kconfig.soc"
osource "/home/enovo/zephyrproject/zephyr/soc/native/inf_clock/Kconfig.soc"
osource "/home/enovo/zephyrproject/zephyr/soc/microchip/sam/sama7/Kconfig.soc"
osource "/home/enovo/zephyrproject/zephyr/soc/microchip/sam/sam_d5x_e5x/Kconfig.soc"
osource "/home/enovo/zephyrproject/zephyr/soc/microchip/pic64/Kconfig.soc"
osource "/home/enovo/zephyrproject/zephyr/soc/microchip/pic32c/pic32cz_ca/Kconfig.soc"
osource "/home/enovo/zephyrproject/zephyr/soc/microchip/pic32c/pic32cx_sg/Kconfig.soc"
osource "/home/enovo/zephyrproject/zephyr/soc/microchip/pic32c/pic32cm_pl/Kconfig.soc"
osource "/home/enovo/zephyrproject/zephyr/soc/microchip/pic32c/pic32cm_jh/Kconfig.soc"
osource "/home/enovo/zephyrproject/zephyr/soc/microchip/miv/Kconfig.soc"
osource "/home/enovo/zephyrproject/zephyr/soc/microchip/mec/Kconfig.soc"
osource "/home/enovo/zephyrproject/zephyr/soc/mediatek/mt8xxx/Kconfig.soc"
osource "/home/enovo/zephyrproject/zephyr/soc/lowrisc/opentitan/Kconfig.soc"
osource "/home/enovo/zephyrproject/zephyr/soc/litex/litex_vexriscv/Kconfig.soc"
osource "/home/enovo/zephyrproject/zephyr/soc/ite/ec/Kconfig.soc"
osource "/home/enovo/zephyrproject/zephyr/soc/intel/wildcat_lake/Kconfig.soc"
osource "/home/enovo/zephyrproject/zephyr/soc/intel/raptor_lake/Kconfig.soc"
osource "/home/enovo/zephyrproject/zephyr/soc/intel/panther_lake/Kconfig.soc"
osource "/home/enovo/zephyrproject/zephyr/soc/intel/lakemont/Kconfig.soc"
osource "/home/enovo/zephyrproject/zephyr/soc/intel/intel_socfpga_std/Kconfig.soc"
osource "/home/enovo/zephyrproject/zephyr/soc/intel/intel_socfpga/Kconfig.soc"
osource "/home/enovo/zephyrproject/zephyr/soc/intel/intel_niosv/Kconfig.soc"
osource "/home/enovo/zephyrproject/zephyr/soc/intel/intel_ish/Kconfig.soc"
osource "/home/enovo/zephyrproject/zephyr/soc/intel/intel_adsp/Kconfig.soc"
osource "/home/enovo/zephyrproject/zephyr/soc/intel/elkhart_lake/Kconfig.soc"
osource "/home/enovo/zephyrproject/zephyr/soc/intel/atom/Kconfig.soc"
osource "/home/enovo/zephyrproject/zephyr/soc/intel/apollo_lake/Kconfig.soc"
osource "/home/enovo/zephyrproject/zephyr/soc/intel/alder_lake/Kconfig.soc"
osource "/home/enovo/zephyrproject/zephyr/soc/infineon/psoc4/Kconfig.soc"
osource "/home/enovo/zephyrproject/zephyr/soc/infineon/edge/Kconfig.soc"
osource "/home/enovo/zephyrproject/zephyr/soc/infineon/cat3/Kconfig.soc"
osource "/home/enovo/zephyrproject/zephyr/soc/infineon/cat1c/Kconfig.soc"
osource "/home/enovo/zephyrproject/zephyr/soc/infineon/cat1b/Kconfig.soc"
osource "/home/enovo/zephyrproject/zephyr/soc/infineon/cat1a/Kconfig.soc"
osource "/home/enovo/zephyrproject/zephyr/soc/gd/gd32/Kconfig.soc"
osource "/home/enovo/zephyrproject/zephyr/soc/gaisler/leon3/Kconfig.soc"
osource "/home/enovo/zephyrproject/zephyr/soc/gaisler/gr716a/Kconfig.soc"
osource "/home/enovo/zephyrproject/zephyr/soc/focaltech/Kconfig.soc"
osource "/home/enovo/zephyrproject/zephyr/soc/espressif/Kconfig.soc"
osource "/home/enovo/zephyrproject/zephyr/soc/ene/kb1200/Kconfig.soc"
osource "/home/enovo/zephyrproject/zephyr/soc/ene/kb106x/Kconfig.soc"
osource "/home/enovo/zephyrproject/zephyr/soc/elan/em32f967/Kconfig.soc"
osource "/home/enovo/zephyrproject/zephyr/soc/egis/Kconfig.soc"
osource "/home/enovo/zephyrproject/zephyr/soc/efinix/sapphire/Kconfig.soc"
osource "/home/enovo/zephyrproject/zephyr/soc/cdns/xtensa_sample_controller/Kconfig.soc"
osource "/home/enovo/zephyrproject/zephyr/soc/cdns/sample_controller32/Kconfig.soc"
osource "/home/enovo/zephyrproject/zephyr/soc/cdns/dc233c/Kconfig.soc"
osource "/home/enovo/zephyrproject/zephyr/soc/brcm/bcmvk/Kconfig.soc"
osource "/home/enovo/zephyrproject/zephyr/soc/brcm/bcm2712/Kconfig.soc"
osource "/home/enovo/zephyrproject/zephyr/soc/brcm/bcm2711/Kconfig.soc"
osource "/home/enovo/zephyrproject/zephyr/soc/blackberry/qnxhv_vm/Kconfig.soc"
osource "/home/enovo/zephyrproject/zephyr/soc/bflb/Kconfig.soc"
osource "/home/enovo/zephyrproject/zephyr/soc/atmel/sam0/Kconfig.soc"
osource "/home/enovo/zephyrproject/zephyr/soc/atmel/sam/Kconfig.soc"
osource "/home/enovo/zephyrproject/zephyr/soc/aspeed/Kconfig.soc"
osource "/home/enovo/zephyrproject/zephyr/soc/arm/Kconfig.soc"
osource "/home/enovo/zephyrproject/zephyr/soc/arm/beetle/Kconfig.soc"
osource "/home/enovo/zephyrproject/zephyr/soc/antmicro/myra/Kconfig.soc"
osource "/home/enovo/zephyrproject/zephyr/soc/andestech/Kconfig.soc"
osource "/home/enovo/zephyrproject/zephyr/soc/amd/acp_6_0/Kconfig.soc"
osource "/home/enovo/zephyrproject/zephyr/soc/ambiq/Kconfig.soc"
osource "/home/enovo/zephyrproject/zephyr/soc/allwinner/sun8i_h3/Kconfig.soc"
osource "/home/enovo/zephyrproject/zephyr/soc/alif/ensemble/Kconfig.soc"
osource "/home/enovo/zephyrproject/zephyr/soc/aesc/Kconfig.soc"
osource "/home/enovo/zephyrproject/zephyr/soc/adi/max32/Kconfig.soc"
```

## twister-out/native_sim_native/host_gnu/applications/zephyr-course/tests/ring_buf/homework.unit.ring_buf/Kconfig/Kconfig.modules
```kconfig
menu "cmsis_6 (/home/lorsi/zephyrproject/deps/modules/hal/cmsis_6)"
osource "$(ZEPHYR_CMSIS_6_KCONFIG)"
config ZEPHYR_CMSIS_6_MODULE
	bool
	default y
endmenu
```

## twister-out/native_sim_native/host_gnu/applications/zephyr-course/tests/ring_buf/homework.unit.ring_buf/Kconfig/arch/Kconfig
```kconfig
# Load Zephyr Arch Kconfig descriptions.
osource "/home/lorsi/zephyrproject/deps/zephyr/arch/rx/Kconfig"
osource "/home/lorsi/zephyrproject/deps/zephyr/arch/x86/Kconfig"
osource "/home/lorsi/zephyrproject/deps/zephyr/arch/xtensa/Kconfig"
osource "/home/lorsi/zephyrproject/deps/zephyr/arch/sparc/Kconfig"
osource "/home/lorsi/zephyrproject/deps/zephyr/arch/riscv/Kconfig"
osource "/home/lorsi/zephyrproject/deps/zephyr/arch/posix/Kconfig"
osource "/home/lorsi/zephyrproject/deps/zephyr/arch/openrisc/Kconfig"
osource "/home/lorsi/zephyrproject/deps/zephyr/arch/mips/Kconfig"
osource "/home/lorsi/zephyrproject/deps/zephyr/arch/arm64/Kconfig"
osource "/home/lorsi/zephyrproject/deps/zephyr/arch/arm/Kconfig"
osource "/home/lorsi/zephyrproject/deps/zephyr/arch/arc/Kconfig"
```

## twister-out/native_sim_native/host_gnu/applications/zephyr-course/tests/ring_buf/homework.unit.ring_buf/Kconfig/boards/Kconfig.defconfig.tmp
```kconfig
# Load Zephyr board defconfig descriptions.
osource "/home/lorsi/zephyrproject/deps/zephyr/boards/native/native_sim/Kconfig.defconfig"
```

## twister-out/native_sim_native/host_gnu/applications/zephyr-course/tests/ring_buf/homework.unit.ring_buf/Kconfig/boards/Kconfig.sysbuild
```kconfig
# Load Sysbuild board Kconfig descriptions.
osource "/home/lorsi/zephyrproject/deps/zephyr/boards/native/native_sim/Kconfig.sysbuild"
```

## twister-out/native_sim_native/host_gnu/applications/zephyr-course/tests/ring_buf/homework.unit.ring_buf/Kconfig/boards/Kconfig.tmp
```kconfig
# Load Zephyr board Kconfig descriptions.
osource "/home/lorsi/zephyrproject/deps/zephyr/boards/native/native_sim/Kconfig"
```
