## twister-out/native_sim_native/host_gnu/applications/zephyr-course/tests/ring_buf/homework.unit.ring_buf/Kconfig/soc/Kconfig
```kconfig
# Load Zephyr SoC Kconfig descriptions.
osource "/home/lorsi/zephyrproject/deps/zephyr/soc/xlnx/zynqmp/Kconfig"
osource "/home/lorsi/zephyrproject/deps/zephyr/soc/xlnx/zynq7000/Kconfig"
osource "/home/lorsi/zephyrproject/deps/zephyr/soc/xlnx/versalnet/Kconfig"
osource "/home/lorsi/zephyrproject/deps/zephyr/soc/xlnx/versal2/Kconfig"
osource "/home/lorsi/zephyrproject/deps/zephyr/soc/xlnx/versal/Kconfig"
osource "/home/lorsi/zephyrproject/deps/zephyr/soc/xen/Kconfig"
osource "/home/lorsi/zephyrproject/deps/zephyr/soc/wch/ch32v/Kconfig"
osource "/home/lorsi/zephyrproject/deps/zephyr/soc/ti/simplelink/Kconfig"
osource "/home/lorsi/zephyrproject/deps/zephyr/soc/ti/mspm0/Kconfig"
osource "/home/lorsi/zephyrproject/deps/zephyr/soc/ti/lm3s6965/Kconfig"
osource "/home/lorsi/zephyrproject/deps/zephyr/soc/ti/k3/Kconfig"
osource "/home/lorsi/zephyrproject/deps/zephyr/soc/telink/tlsr/Kconfig"
osource "/home/lorsi/zephyrproject/deps/zephyr/soc/syna/sr100/Kconfig"
osource "/home/lorsi/zephyrproject/deps/zephyr/soc/starfive/jh71xx/Kconfig"
osource "/home/lorsi/zephyrproject/deps/zephyr/soc/st/stm32/Kconfig"
osource "/home/lorsi/zephyrproject/deps/zephyr/soc/snps/qemu_arc/Kconfig"
osource "/home/lorsi/zephyrproject/deps/zephyr/soc/snps/nsim/arc_v/Kconfig"
osource "/home/lorsi/zephyrproject/deps/zephyr/soc/snps/nsim/arc_classic/Kconfig"
osource "/home/lorsi/zephyrproject/deps/zephyr/soc/snps/hsdk4xd/Kconfig"
osource "/home/lorsi/zephyrproject/deps/zephyr/soc/snps/hsdk/Kconfig"
osource "/home/lorsi/zephyrproject/deps/zephyr/soc/snps/emsk/Kconfig"
osource "/home/lorsi/zephyrproject/deps/zephyr/soc/snps/emsdp/Kconfig"
osource "/home/lorsi/zephyrproject/deps/zephyr/soc/snps/arc_iot/Kconfig"
osource "/home/lorsi/zephyrproject/deps/zephyr/soc/silabs/Kconfig"
osource "/home/lorsi/zephyrproject/deps/zephyr/soc/sifli/sf32/Kconfig"
osource "/home/lorsi/zephyrproject/deps/zephyr/soc/sifive/sifive_freedom/Kconfig"
osource "/home/lorsi/zephyrproject/deps/zephyr/soc/sensry/Kconfig"
osource "/home/lorsi/zephyrproject/deps/zephyr/soc/rockchip/Kconfig"
osource "/home/lorsi/zephyrproject/deps/zephyr/soc/renode/riscv_virtual/Kconfig"
osource "/home/lorsi/zephyrproject/deps/zephyr/soc/renode/cortex_r8_virtual/Kconfig"
osource "/home/lorsi/zephyrproject/deps/zephyr/soc/renesas/smartbond/Kconfig"
osource "/home/lorsi/zephyrproject/deps/zephyr/soc/renesas/rz/Kconfig"
osource "/home/lorsi/zephyrproject/deps/zephyr/soc/renesas/rx/Kconfig"
osource "/home/lorsi/zephyrproject/deps/zephyr/soc/renesas/rcar/Kconfig"
osource "/home/lorsi/zephyrproject/deps/zephyr/soc/renesas/ra/Kconfig"
osource "/home/lorsi/zephyrproject/deps/zephyr/soc/realtek/fingerprint/Kconfig"
osource "/home/lorsi/zephyrproject/deps/zephyr/soc/realtek/ec/Kconfig"
osource "/home/lorsi/zephyrproject/deps/zephyr/soc/realtek/bee/Kconfig"
osource "/home/lorsi/zephyrproject/deps/zephyr/soc/realtek/ameba/Kconfig"
osource "/home/lorsi/zephyrproject/deps/zephyr/soc/raspberrypi/rpi_pico/Kconfig"
osource "/home/lorsi/zephyrproject/deps/zephyr/soc/quicklogic/eos_s3/Kconfig"
osource "/home/lorsi/zephyrproject/deps/zephyr/soc/qemu/virt_riscv/Kconfig"
osource "/home/lorsi/zephyrproject/deps/zephyr/soc/qemu/or1k/Kconfig"
osource "/home/lorsi/zephyrproject/deps/zephyr/soc/qemu/malta/Kconfig"
osource "/home/lorsi/zephyrproject/deps/zephyr/soc/openisa/rv32m1/Kconfig"
osource "/home/lorsi/zephyrproject/deps/zephyr/soc/openhwgroup/cva6/Kconfig"
osource "/home/lorsi/zephyrproject/deps/zephyr/soc/oct/osd32mp15x/Kconfig"
osource "/home/lorsi/zephyrproject/deps/zephyr/soc/nxp/s32/Kconfig"
osource "/home/lorsi/zephyrproject/deps/zephyr/soc/nxp/rw/Kconfig"
osource "/home/lorsi/zephyrproject/deps/zephyr/soc/nxp/mcx/Kconfig"
osource "/home/lorsi/zephyrproject/deps/zephyr/soc/nxp/lpc/Kconfig"
osource "/home/lorsi/zephyrproject/deps/zephyr/soc/nxp/layerscape/Kconfig"
osource "/home/lorsi/zephyrproject/deps/zephyr/soc/nxp/kinetis/Kconfig"
osource "/home/lorsi/zephyrproject/deps/zephyr/soc/nxp/imxrt/Kconfig"
osource "/home/lorsi/zephyrproject/deps/zephyr/soc/nxp/imx/Kconfig"
osource "/home/lorsi/zephyrproject/deps/zephyr/soc/nuvoton/numicro/Kconfig"
osource "/home/lorsi/zephyrproject/deps/zephyr/soc/nuvoton/numaker/Kconfig"
osource "/home/lorsi/zephyrproject/deps/zephyr/soc/nuvoton/npcx/Kconfig"
osource "/home/lorsi/zephyrproject/deps/zephyr/soc/nuvoton/npcm/Kconfig"
osource "/home/lorsi/zephyrproject/deps/zephyr/soc/nordic/Kconfig"
osource "/home/lorsi/zephyrproject/deps/zephyr/soc/neorv32/Kconfig"
osource "/home/lorsi/zephyrproject/deps/zephyr/soc/native/inf_clock/Kconfig"
osource "/home/lorsi/zephyrproject/deps/zephyr/soc/microchip/sam/sama7/Kconfig"
osource "/home/lorsi/zephyrproject/deps/zephyr/soc/microchip/sam/sam_d5x_e5x/Kconfig"
osource "/home/lorsi/zephyrproject/deps/zephyr/soc/microchip/pic64/Kconfig"
osource "/home/lorsi/zephyrproject/deps/zephyr/soc/microchip/pic32c/pic32cz_ca/Kconfig"
osource "/home/lorsi/zephyrproject/deps/zephyr/soc/microchip/pic32c/pic32cx_sg/Kconfig"
osource "/home/lorsi/zephyrproject/deps/zephyr/soc/microchip/pic32c/pic32cm_pl/Kconfig"
osource "/home/lorsi/zephyrproject/deps/zephyr/soc/microchip/pic32c/pic32cm_jh/Kconfig"
osource "/home/lorsi/zephyrproject/deps/zephyr/soc/microchip/miv/Kconfig"
osource "/home/lorsi/zephyrproject/deps/zephyr/soc/microchip/mec/Kconfig"
osource "/home/lorsi/zephyrproject/deps/zephyr/soc/mediatek/mt8xxx/Kconfig"
osource "/home/lorsi/zephyrproject/deps/zephyr/soc/lowrisc/opentitan/Kconfig"
osource "/home/lorsi/zephyrproject/deps/zephyr/soc/litex/litex_vexriscv/Kconfig"
osource "/home/lorsi/zephyrproject/deps/zephyr/soc/ite/ec/Kconfig"
osource "/home/lorsi/zephyrproject/deps/zephyr/soc/intel/wildcat_lake/Kconfig"
osource "/home/lorsi/zephyrproject/deps/zephyr/soc/intel/raptor_lake/Kconfig"
osource "/home/lorsi/zephyrproject/deps/zephyr/soc/intel/panther_lake/Kconfig"
osource "/home/lorsi/zephyrproject/deps/zephyr/soc/intel/lakemont/Kconfig"
osource "/home/lorsi/zephyrproject/deps/zephyr/soc/intel/intel_socfpga_std/Kconfig"
osource "/home/lorsi/zephyrproject/deps/zephyr/soc/intel/intel_socfpga/Kconfig"
osource "/home/lorsi/zephyrproject/deps/zephyr/soc/intel/intel_niosv/Kconfig"
osource "/home/lorsi/zephyrproject/deps/zephyr/soc/intel/intel_ish/Kconfig"
osource "/home/lorsi/zephyrproject/deps/zephyr/soc/intel/intel_adsp/Kconfig"
osource "/home/lorsi/zephyrproject/deps/zephyr/soc/intel/elkhart_lake/Kconfig"
osource "/home/lorsi/zephyrproject/deps/zephyr/soc/intel/atom/Kconfig"
osource "/home/lorsi/zephyrproject/deps/zephyr/soc/intel/apollo_lake/Kconfig"
osource "/home/lorsi/zephyrproject/deps/zephyr/soc/intel/alder_lake/Kconfig"
osource "/home/lorsi/zephyrproject/deps/zephyr/soc/infineon/psoc4/Kconfig"
osource "/home/lorsi/zephyrproject/deps/zephyr/soc/infineon/edge/Kconfig"
osource "/home/lorsi/zephyrproject/deps/zephyr/soc/infineon/cat3/Kconfig"
osource "/home/lorsi/zephyrproject/deps/zephyr/soc/infineon/cat1c/Kconfig"
osource "/home/lorsi/zephyrproject/deps/zephyr/soc/infineon/cat1b/Kconfig"
osource "/home/lorsi/zephyrproject/deps/zephyr/soc/infineon/cat1a/Kconfig"
osource "/home/lorsi/zephyrproject/deps/zephyr/soc/gd/gd32/Kconfig"
osource "/home/lorsi/zephyrproject/deps/zephyr/soc/gaisler/leon3/Kconfig"
osource "/home/lorsi/zephyrproject/deps/zephyr/soc/gaisler/gr716a/Kconfig"
osource "/home/lorsi/zephyrproject/deps/zephyr/soc/focaltech/Kconfig"
osource "/home/lorsi/zephyrproject/deps/zephyr/soc/espressif/Kconfig"
osource "/home/lorsi/zephyrproject/deps/zephyr/soc/ene/kb1200/Kconfig"
osource "/home/lorsi/zephyrproject/deps/zephyr/soc/ene/kb106x/Kconfig"
osource "/home/lorsi/zephyrproject/deps/zephyr/soc/elan/em32f967/Kconfig"
osource "/home/lorsi/zephyrproject/deps/zephyr/soc/egis/Kconfig"
osource "/home/lorsi/zephyrproject/deps/zephyr/soc/efinix/sapphire/Kconfig"
osource "/home/lorsi/zephyrproject/deps/zephyr/soc/cdns/xtensa_sample_controller/Kconfig"
osource "/home/lorsi/zephyrproject/deps/zephyr/soc/cdns/swerv/Kconfig"
osource "/home/lorsi/zephyrproject/deps/zephyr/soc/cdns/sample_controller32/Kconfig"
osource "/home/lorsi/zephyrproject/deps/zephyr/soc/cdns/dc233c/Kconfig"
osource "/home/lorsi/zephyrproject/deps/zephyr/soc/brcm/bcmvk/Kconfig"
osource "/home/lorsi/zephyrproject/deps/zephyr/soc/brcm/bcm2712/Kconfig"
osource "/home/lorsi/zephyrproject/deps/zephyr/soc/brcm/bcm2711/Kconfig"
osource "/home/lorsi/zephyrproject/deps/zephyr/soc/blackberry/qnxhv_vm/Kconfig"
osource "/home/lorsi/zephyrproject/deps/zephyr/soc/bflb/Kconfig"
osource "/home/lorsi/zephyrproject/deps/zephyr/soc/atmel/sam0/Kconfig"
osource "/home/lorsi/zephyrproject/deps/zephyr/soc/atmel/sam/Kconfig"
osource "/home/lorsi/zephyrproject/deps/zephyr/soc/aspeed/Kconfig"
osource "/home/lorsi/zephyrproject/deps/zephyr/soc/arm/Kconfig"
osource "/home/lorsi/zephyrproject/deps/zephyr/soc/arm/beetle/Kconfig"
osource "/home/lorsi/zephyrproject/deps/zephyr/soc/antmicro/myra/Kconfig"
osource "/home/lorsi/zephyrproject/deps/zephyr/soc/andestech/Kconfig"
osource "/home/lorsi/zephyrproject/deps/zephyr/soc/amd/acp_6_0/Kconfig"
osource "/home/lorsi/zephyrproject/deps/zephyr/soc/ambiq/Kconfig"
osource "/home/lorsi/zephyrproject/deps/zephyr/soc/allwinner/sun8i_h3/Kconfig"
osource "/home/lorsi/zephyrproject/deps/zephyr/soc/alif/ensemble/Kconfig"
osource "/home/lorsi/zephyrproject/deps/zephyr/soc/aesc/Kconfig"
osource "/home/lorsi/zephyrproject/deps/zephyr/soc/adi/max32/Kconfig"
```
