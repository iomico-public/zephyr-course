## boards/our_board/board.yml
```yaml
board:
  name: our_board
  full_name: Our Board
  vendor: mutuma
  socs:
  - name: esp32c6
```

## l4-task1/l4_build/Kconfig/Kconfig.modules
```kconfig
menu "cmsis_6 (/home/enovo/zephyrproject/deps/modules/hal/cmsis_6)"
osource "$(ZEPHYR_CMSIS_6_KCONFIG)"
config ZEPHYR_CMSIS_6_MODULE
	bool
	default y
endmenu
config ZEPHYR_HAL_STM32_MODULE
	bool
	default y

config ZEPHYR_HAL_STM32_MODULE_BLOBS
	bool
```

## l4-task1/l4_build/Kconfig/arch/Kconfig
```kconfig
# Load Zephyr Arch Kconfig descriptions.
osource "/home/enovo/zephyrproject/zephyr/arch/rx/Kconfig"
osource "/home/enovo/zephyrproject/zephyr/arch/x86/Kconfig"
osource "/home/enovo/zephyrproject/zephyr/arch/xtensa/Kconfig"
osource "/home/enovo/zephyrproject/zephyr/arch/sparc/Kconfig"
osource "/home/enovo/zephyrproject/zephyr/arch/riscv/Kconfig"
osource "/home/enovo/zephyrproject/zephyr/arch/posix/Kconfig"
osource "/home/enovo/zephyrproject/zephyr/arch/openrisc/Kconfig"
osource "/home/enovo/zephyrproject/zephyr/arch/mips/Kconfig"
osource "/home/enovo/zephyrproject/zephyr/arch/arm64/Kconfig"
osource "/home/enovo/zephyrproject/zephyr/arch/arm/Kconfig"
osource "/home/enovo/zephyrproject/zephyr/arch/arc/Kconfig"
```

## l4-task1/l4_build/Kconfig/boards/Kconfig.defconfig.tmp
```kconfig
# Load Zephyr board defconfig descriptions.
osource "/home/enovo/zephyrproject/zephyr/boards/st/stm32f4_disco/Kconfig.defconfig"
```

## l4-task1/l4_build/Kconfig/boards/Kconfig.stm32f4_disco.tmp
```kconfig
# Load board Kconfig descriptions.
osource "/home/enovo/zephyrproject/zephyr/boards/st/stm32f4_disco/Kconfig.stm32f4_disco"
```

## l4-task1/l4_build/Kconfig/boards/Kconfig.tmp
```kconfig
# Load Zephyr board Kconfig descriptions.
osource "/home/enovo/zephyrproject/zephyr/boards/st/stm32f4_disco/Kconfig"
```

## l4-task1/l4_build/Kconfig/soc/Kconfig
```kconfig
# Load Zephyr SoC Kconfig descriptions.
osource "/home/enovo/zephyrproject/zephyr/soc/xlnx/zynqmp/Kconfig"
osource "/home/enovo/zephyrproject/zephyr/soc/xlnx/zynq7000/Kconfig"
osource "/home/enovo/zephyrproject/zephyr/soc/xlnx/versalnet/Kconfig"
osource "/home/enovo/zephyrproject/zephyr/soc/xlnx/versal2/Kconfig"
osource "/home/enovo/zephyrproject/zephyr/soc/xlnx/versal/Kconfig"
osource "/home/enovo/zephyrproject/zephyr/soc/xen/Kconfig"
osource "/home/enovo/zephyrproject/zephyr/soc/wch/ch32v/Kconfig"
osource "/home/enovo/zephyrproject/zephyr/soc/ti/simplelink/Kconfig"
osource "/home/enovo/zephyrproject/zephyr/soc/ti/mspm0/Kconfig"
osource "/home/enovo/zephyrproject/zephyr/soc/ti/lm3s6965/Kconfig"
osource "/home/enovo/zephyrproject/zephyr/soc/ti/k3/Kconfig"
osource "/home/enovo/zephyrproject/zephyr/soc/telink/tlsr/Kconfig"
osource "/home/enovo/zephyrproject/zephyr/soc/starfive/jh71xx/Kconfig"
osource "/home/enovo/zephyrproject/zephyr/soc/st/stm32/Kconfig"
osource "/home/enovo/zephyrproject/zephyr/soc/snps/qemu_arc/Kconfig"
osource "/home/enovo/zephyrproject/zephyr/soc/snps/nsim/arc_v/Kconfig"
osource "/home/enovo/zephyrproject/zephyr/soc/snps/nsim/arc_classic/Kconfig"
osource "/home/enovo/zephyrproject/zephyr/soc/snps/hsdk4xd/Kconfig"
osource "/home/enovo/zephyrproject/zephyr/soc/snps/hsdk/Kconfig"
osource "/home/enovo/zephyrproject/zephyr/soc/snps/emsk/Kconfig"
osource "/home/enovo/zephyrproject/zephyr/soc/snps/emsdp/Kconfig"
osource "/home/enovo/zephyrproject/zephyr/soc/snps/arc_iot/Kconfig"
osource "/home/enovo/zephyrproject/zephyr/soc/silabs/Kconfig"
osource "/home/enovo/zephyrproject/zephyr/soc/sifli/sf32/Kconfig"
osource "/home/enovo/zephyrproject/zephyr/soc/sifive/sifive_freedom/Kconfig"
osource "/home/enovo/zephyrproject/zephyr/soc/sensry/Kconfig"
osource "/home/enovo/zephyrproject/zephyr/soc/rockchip/Kconfig"
osource "/home/enovo/zephyrproject/zephyr/soc/renode/riscv_virtual/Kconfig"
osource "/home/enovo/zephyrproject/zephyr/soc/renode/cortex_r8_virtual/Kconfig"
osource "/home/enovo/zephyrproject/zephyr/soc/renesas/smartbond/Kconfig"
osource "/home/enovo/zephyrproject/zephyr/soc/renesas/rz/Kconfig"
osource "/home/enovo/zephyrproject/zephyr/soc/renesas/rx/Kconfig"
osource "/home/enovo/zephyrproject/zephyr/soc/renesas/rcar/Kconfig"
osource "/home/enovo/zephyrproject/zephyr/soc/renesas/ra/Kconfig"
osource "/home/enovo/zephyrproject/zephyr/soc/realtek/fingerprint/Kconfig"
osource "/home/enovo/zephyrproject/zephyr/soc/realtek/ec/Kconfig"
osource "/home/enovo/zephyrproject/zephyr/soc/realtek/bee/Kconfig"
osource "/home/enovo/zephyrproject/zephyr/soc/realtek/ameba/Kconfig"
osource "/home/enovo/zephyrproject/zephyr/soc/raspberrypi/rpi_pico/Kconfig"
osource "/home/enovo/zephyrproject/zephyr/soc/quicklogic/eos_s3/Kconfig"
osource "/home/enovo/zephyrproject/zephyr/soc/qemu/virt_riscv/Kconfig"
osource "/home/enovo/zephyrproject/zephyr/soc/qemu/or1k/Kconfig"
osource "/home/enovo/zephyrproject/zephyr/soc/qemu/malta/Kconfig"
osource "/home/enovo/zephyrproject/zephyr/soc/openisa/rv32m1/Kconfig"
osource "/home/enovo/zephyrproject/zephyr/soc/openhwgroup/cva6/Kconfig"
osource "/home/enovo/zephyrproject/zephyr/soc/oct/osd32mp15x/Kconfig"
osource "/home/enovo/zephyrproject/zephyr/soc/nxp/s32/Kconfig"
osource "/home/enovo/zephyrproject/zephyr/soc/nxp/rw/Kconfig"
osource "/home/enovo/zephyrproject/zephyr/soc/nxp/mcx/Kconfig"
osource "/home/enovo/zephyrproject/zephyr/soc/nxp/lpc/Kconfig"
osource "/home/enovo/zephyrproject/zephyr/soc/nxp/layerscape/Kconfig"
osource "/home/enovo/zephyrproject/zephyr/soc/nxp/kinetis/Kconfig"
osource "/home/enovo/zephyrproject/zephyr/soc/nxp/imxrt/Kconfig"
osource "/home/enovo/zephyrproject/zephyr/soc/nxp/imx/Kconfig"
osource "/home/enovo/zephyrproject/zephyr/soc/nuvoton/numicro/Kconfig"
osource "/home/enovo/zephyrproject/zephyr/soc/nuvoton/numaker/Kconfig"
osource "/home/enovo/zephyrproject/zephyr/soc/nuvoton/npcx/Kconfig"
osource "/home/enovo/zephyrproject/zephyr/soc/nuvoton/npcm/Kconfig"
osource "/home/enovo/zephyrproject/zephyr/soc/nordic/Kconfig"
osource "/home/enovo/zephyrproject/zephyr/soc/neorv32/Kconfig"
osource "/home/enovo/zephyrproject/zephyr/soc/native/inf_clock/Kconfig"
osource "/home/enovo/zephyrproject/zephyr/soc/microchip/sam/sama7/Kconfig"
osource "/home/enovo/zephyrproject/zephyr/soc/microchip/sam/sam_d5x_e5x/Kconfig"
osource "/home/enovo/zephyrproject/zephyr/soc/microchip/pic64/Kconfig"
osource "/home/enovo/zephyrproject/zephyr/soc/microchip/pic32c/pic32cz_ca/Kconfig"
osource "/home/enovo/zephyrproject/zephyr/soc/microchip/pic32c/pic32cx_sg/Kconfig"
osource "/home/enovo/zephyrproject/zephyr/soc/microchip/pic32c/pic32cm_pl/Kconfig"
osource "/home/enovo/zephyrproject/zephyr/soc/microchip/pic32c/pic32cm_jh/Kconfig"
osource "/home/enovo/zephyrproject/zephyr/soc/microchip/miv/Kconfig"
osource "/home/enovo/zephyrproject/zephyr/soc/microchip/mec/Kconfig"
osource "/home/enovo/zephyrproject/zephyr/soc/mediatek/mt8xxx/Kconfig"
osource "/home/enovo/zephyrproject/zephyr/soc/lowrisc/opentitan/Kconfig"
osource "/home/enovo/zephyrproject/zephyr/soc/litex/litex_vexriscv/Kconfig"
osource "/home/enovo/zephyrproject/zephyr/soc/ite/ec/Kconfig"
osource "/home/enovo/zephyrproject/zephyr/soc/intel/wildcat_lake/Kconfig"
osource "/home/enovo/zephyrproject/zephyr/soc/intel/raptor_lake/Kconfig"
osource "/home/enovo/zephyrproject/zephyr/soc/intel/panther_lake/Kconfig"
osource "/home/enovo/zephyrproject/zephyr/soc/intel/lakemont/Kconfig"
osource "/home/enovo/zephyrproject/zephyr/soc/intel/intel_socfpga_std/Kconfig"
osource "/home/enovo/zephyrproject/zephyr/soc/intel/intel_socfpga/Kconfig"
osource "/home/enovo/zephyrproject/zephyr/soc/intel/intel_niosv/Kconfig"
osource "/home/enovo/zephyrproject/zephyr/soc/intel/intel_ish/Kconfig"
osource "/home/enovo/zephyrproject/zephyr/soc/intel/intel_adsp/Kconfig"
osource "/home/enovo/zephyrproject/zephyr/soc/intel/elkhart_lake/Kconfig"
osource "/home/enovo/zephyrproject/zephyr/soc/intel/atom/Kconfig"
osource "/home/enovo/zephyrproject/zephyr/soc/intel/apollo_lake/Kconfig"
osource "/home/enovo/zephyrproject/zephyr/soc/intel/alder_lake/Kconfig"
osource "/home/enovo/zephyrproject/zephyr/soc/infineon/psoc4/Kconfig"
osource "/home/enovo/zephyrproject/zephyr/soc/infineon/edge/Kconfig"
osource "/home/enovo/zephyrproject/zephyr/soc/infineon/cat3/Kconfig"
osource "/home/enovo/zephyrproject/zephyr/soc/infineon/cat1c/Kconfig"
osource "/home/enovo/zephyrproject/zephyr/soc/infineon/cat1b/Kconfig"
osource "/home/enovo/zephyrproject/zephyr/soc/infineon/cat1a/Kconfig"
osource "/home/enovo/zephyrproject/zephyr/soc/gd/gd32/Kconfig"
osource "/home/enovo/zephyrproject/zephyr/soc/gaisler/leon3/Kconfig"
osource "/home/enovo/zephyrproject/zephyr/soc/gaisler/gr716a/Kconfig"
osource "/home/enovo/zephyrproject/zephyr/soc/focaltech/Kconfig"
osource "/home/enovo/zephyrproject/zephyr/soc/espressif/Kconfig"
osource "/home/enovo/zephyrproject/zephyr/soc/ene/kb1200/Kconfig"
osource "/home/enovo/zephyrproject/zephyr/soc/ene/kb106x/Kconfig"
osource "/home/enovo/zephyrproject/zephyr/soc/elan/em32f967/Kconfig"
osource "/home/enovo/zephyrproject/zephyr/soc/egis/Kconfig"
osource "/home/enovo/zephyrproject/zephyr/soc/efinix/sapphire/Kconfig"
osource "/home/enovo/zephyrproject/zephyr/soc/cdns/xtensa_sample_controller/Kconfig"
osource "/home/enovo/zephyrproject/zephyr/soc/cdns/sample_controller32/Kconfig"
osource "/home/enovo/zephyrproject/zephyr/soc/cdns/dc233c/Kconfig"
osource "/home/enovo/zephyrproject/zephyr/soc/brcm/bcmvk/Kconfig"
osource "/home/enovo/zephyrproject/zephyr/soc/brcm/bcm2712/Kconfig"
osource "/home/enovo/zephyrproject/zephyr/soc/brcm/bcm2711/Kconfig"
osource "/home/enovo/zephyrproject/zephyr/soc/blackberry/qnxhv_vm/Kconfig"
osource "/home/enovo/zephyrproject/zephyr/soc/bflb/Kconfig"
osource "/home/enovo/zephyrproject/zephyr/soc/atmel/sam0/Kconfig"
osource "/home/enovo/zephyrproject/zephyr/soc/atmel/sam/Kconfig"
osource "/home/enovo/zephyrproject/zephyr/soc/aspeed/Kconfig"
osource "/home/enovo/zephyrproject/zephyr/soc/arm/Kconfig"
osource "/home/enovo/zephyrproject/zephyr/soc/arm/beetle/Kconfig"
osource "/home/enovo/zephyrproject/zephyr/soc/antmicro/myra/Kconfig"
osource "/home/enovo/zephyrproject/zephyr/soc/andestech/Kconfig"
osource "/home/enovo/zephyrproject/zephyr/soc/amd/acp_6_0/Kconfig"
osource "/home/enovo/zephyrproject/zephyr/soc/ambiq/Kconfig"
osource "/home/enovo/zephyrproject/zephyr/soc/allwinner/sun8i_h3/Kconfig"
osource "/home/enovo/zephyrproject/zephyr/soc/alif/ensemble/Kconfig"
osource "/home/enovo/zephyrproject/zephyr/soc/aesc/Kconfig"
osource "/home/enovo/zephyrproject/zephyr/soc/adi/max32/Kconfig"
```
