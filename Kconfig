## twister-out/native_sim_native/host_gnu/zephyr-course-stm32-c562re/tests/ring_buf/homework.unit.ring_buf/Kconfig/soc/Kconfig.sysbuild
```kconfig
# Load Sysbuild SoC Kconfig descriptions.
osource "/home/mirafra/Girish/GITHUB/Zephyr_Workspace/zephyrproject/zephyr/soc/xlnx/zynqmp/Kconfig.sysbuild"
osource "/home/mirafra/Girish/GITHUB/Zephyr_Workspace/zephyrproject/zephyr/soc/xlnx/zynq7000/Kconfig.sysbuild"
osource "/home/mirafra/Girish/GITHUB/Zephyr_Workspace/zephyrproject/zephyr/soc/xlnx/versalnet/Kconfig.sysbuild"
osource "/home/mirafra/Girish/GITHUB/Zephyr_Workspace/zephyrproject/zephyr/soc/xlnx/versal2/Kconfig.sysbuild"
osource "/home/mirafra/Girish/GITHUB/Zephyr_Workspace/zephyrproject/zephyr/soc/xlnx/versal/Kconfig.sysbuild"
osource "/home/mirafra/Girish/GITHUB/Zephyr_Workspace/zephyrproject/zephyr/soc/xen/Kconfig.sysbuild"
osource "/home/mirafra/Girish/GITHUB/Zephyr_Workspace/zephyrproject/zephyr/soc/wch/ch32v/Kconfig.sysbuild"
osource "/home/mirafra/Girish/GITHUB/Zephyr_Workspace/zephyrproject/zephyr/soc/ti/tiva_c/Kconfig.sysbuild"
osource "/home/mirafra/Girish/GITHUB/Zephyr_Workspace/zephyrproject/zephyr/soc/ti/simplelink/Kconfig.sysbuild"
osource "/home/mirafra/Girish/GITHUB/Zephyr_Workspace/zephyrproject/zephyr/soc/ti/mspm/Kconfig.sysbuild"
osource "/home/mirafra/Girish/GITHUB/Zephyr_Workspace/zephyrproject/zephyr/soc/ti/lm3s6965/Kconfig.sysbuild"
osource "/home/mirafra/Girish/GITHUB/Zephyr_Workspace/zephyrproject/zephyr/soc/ti/k3/Kconfig.sysbuild"
osource "/home/mirafra/Girish/GITHUB/Zephyr_Workspace/zephyrproject/zephyr/soc/ti/am13/Kconfig.sysbuild"
osource "/home/mirafra/Girish/GITHUB/Zephyr_Workspace/zephyrproject/zephyr/soc/telink/tlsr/Kconfig.sysbuild"
osource "/home/mirafra/Girish/GITHUB/Zephyr_Workspace/zephyrproject/zephyr/soc/syna/sr100/Kconfig.sysbuild"
osource "/home/mirafra/Girish/GITHUB/Zephyr_Workspace/zephyrproject/zephyr/soc/starfive/jh71xx/Kconfig.sysbuild"
osource "/home/mirafra/Girish/GITHUB/Zephyr_Workspace/zephyrproject/zephyr/soc/st/stm32/Kconfig.sysbuild"
osource "/home/mirafra/Girish/GITHUB/Zephyr_Workspace/zephyrproject/zephyr/soc/snps/qemu_arc/Kconfig.sysbuild"
osource "/home/mirafra/Girish/GITHUB/Zephyr_Workspace/zephyrproject/zephyr/soc/snps/nsim/arc_v/Kconfig.sysbuild"
osource "/home/mirafra/Girish/GITHUB/Zephyr_Workspace/zephyrproject/zephyr/soc/snps/nsim/arc_classic/Kconfig.sysbuild"
osource "/home/mirafra/Girish/GITHUB/Zephyr_Workspace/zephyrproject/zephyr/soc/snps/hsdk4xd/Kconfig.sysbuild"
osource "/home/mirafra/Girish/GITHUB/Zephyr_Workspace/zephyrproject/zephyr/soc/snps/hsdk/Kconfig.sysbuild"
osource "/home/mirafra/Girish/GITHUB/Zephyr_Workspace/zephyrproject/zephyr/soc/snps/emsk/Kconfig.sysbuild"
osource "/home/mirafra/Girish/GITHUB/Zephyr_Workspace/zephyrproject/zephyr/soc/snps/emsdp/Kconfig.sysbuild"
osource "/home/mirafra/Girish/GITHUB/Zephyr_Workspace/zephyrproject/zephyr/soc/snps/arc_iot/Kconfig.sysbuild"
osource "/home/mirafra/Girish/GITHUB/Zephyr_Workspace/zephyrproject/zephyr/soc/silabs/Kconfig.sysbuild"
osource "/home/mirafra/Girish/GITHUB/Zephyr_Workspace/zephyrproject/zephyr/soc/sifli/sf32/Kconfig.sysbuild"
osource "/home/mirafra/Girish/GITHUB/Zephyr_Workspace/zephyrproject/zephyr/soc/sifive/sifive_freedom/Kconfig.sysbuild"
osource "/home/mirafra/Girish/GITHUB/Zephyr_Workspace/zephyrproject/zephyr/soc/shakti/Kconfig.sysbuild"
osource "/home/mirafra/Girish/GITHUB/Zephyr_Workspace/zephyrproject/zephyr/soc/sensry/Kconfig.sysbuild"
osource "/home/mirafra/Girish/GITHUB/Zephyr_Workspace/zephyrproject/zephyr/soc/rockchip/Kconfig.sysbuild"
osource "/home/mirafra/Girish/GITHUB/Zephyr_Workspace/zephyrproject/zephyr/soc/renode/riscv_virtual/Kconfig.sysbuild"
osource "/home/mirafra/Girish/GITHUB/Zephyr_Workspace/zephyrproject/zephyr/soc/renode/cortex_r8_virtual/Kconfig.sysbuild"
osource "/home/mirafra/Girish/GITHUB/Zephyr_Workspace/zephyrproject/zephyr/soc/renesas/smartbond/Kconfig.sysbuild"
osource "/home/mirafra/Girish/GITHUB/Zephyr_Workspace/zephyrproject/zephyr/soc/renesas/rz/Kconfig.sysbuild"
osource "/home/mirafra/Girish/GITHUB/Zephyr_Workspace/zephyrproject/zephyr/soc/renesas/rx/Kconfig.sysbuild"
osource "/home/mirafra/Girish/GITHUB/Zephyr_Workspace/zephyrproject/zephyr/soc/renesas/rcar/Kconfig.sysbuild"
osource "/home/mirafra/Girish/GITHUB/Zephyr_Workspace/zephyrproject/zephyr/soc/renesas/ra/Kconfig.sysbuild"
osource "/home/mirafra/Girish/GITHUB/Zephyr_Workspace/zephyrproject/zephyr/soc/realtek/fingerprint/Kconfig.sysbuild"
osource "/home/mirafra/Girish/GITHUB/Zephyr_Workspace/zephyrproject/zephyr/soc/realtek/ec/Kconfig.sysbuild"
osource "/home/mirafra/Girish/GITHUB/Zephyr_Workspace/zephyrproject/zephyr/soc/realtek/bee/Kconfig.sysbuild"
osource "/home/mirafra/Girish/GITHUB/Zephyr_Workspace/zephyrproject/zephyr/soc/realtek/ameba/Kconfig.sysbuild"
osource "/home/mirafra/Girish/GITHUB/Zephyr_Workspace/zephyrproject/zephyr/soc/raspberrypi/rpi_pico/Kconfig.sysbuild"
osource "/home/mirafra/Girish/GITHUB/Zephyr_Workspace/zephyrproject/zephyr/soc/quicklogic/eos_s3/Kconfig.sysbuild"
osource "/home/mirafra/Girish/GITHUB/Zephyr_Workspace/zephyrproject/zephyr/soc/qemu/virt_riscv/Kconfig.sysbuild"
osource "/home/mirafra/Girish/GITHUB/Zephyr_Workspace/zephyrproject/zephyr/soc/qemu/tricore/Kconfig.sysbuild"
osource "/home/mirafra/Girish/GITHUB/Zephyr_Workspace/zephyrproject/zephyr/soc/qemu/or1k/Kconfig.sysbuild"
osource "/home/mirafra/Girish/GITHUB/Zephyr_Workspace/zephyrproject/zephyr/soc/qemu/malta/Kconfig.sysbuild"
osource "/home/mirafra/Girish/GITHUB/Zephyr_Workspace/zephyrproject/zephyr/soc/qemu/hexagon/Kconfig.sysbuild"
osource "/home/mirafra/Girish/GITHUB/Zephyr_Workspace/zephyrproject/zephyr/soc/openisa/rv32m1/Kconfig.sysbuild"
osource "/home/mirafra/Girish/GITHUB/Zephyr_Workspace/zephyrproject/zephyr/soc/openhwgroup/erbium/Kconfig.sysbuild"
osource "/home/mirafra/Girish/GITHUB/Zephyr_Workspace/zephyrproject/zephyr/soc/openhwgroup/cva6/Kconfig.sysbuild"
osource "/home/mirafra/Girish/GITHUB/Zephyr_Workspace/zephyrproject/zephyr/soc/oct/osd32mp15x/Kconfig.sysbuild"
osource "/home/mirafra/Girish/GITHUB/Zephyr_Workspace/zephyrproject/zephyr/soc/nxp/s32/Kconfig.sysbuild"
osource "/home/mirafra/Girish/GITHUB/Zephyr_Workspace/zephyrproject/zephyr/soc/nxp/rw/Kconfig.sysbuild"
osource "/home/mirafra/Girish/GITHUB/Zephyr_Workspace/zephyrproject/zephyr/soc/nxp/mcx/Kconfig.sysbuild"
osource "/home/mirafra/Girish/GITHUB/Zephyr_Workspace/zephyrproject/zephyr/soc/nxp/lpc/Kconfig.sysbuild"
osource "/home/mirafra/Girish/GITHUB/Zephyr_Workspace/zephyrproject/zephyr/soc/nxp/layerscape/Kconfig.sysbuild"
osource "/home/mirafra/Girish/GITHUB/Zephyr_Workspace/zephyrproject/zephyr/soc/nxp/kinetis/Kconfig.sysbuild"
osource "/home/mirafra/Girish/GITHUB/Zephyr_Workspace/zephyrproject/zephyr/soc/nxp/imxrt/Kconfig.sysbuild"
osource "/home/mirafra/Girish/GITHUB/Zephyr_Workspace/zephyrproject/zephyr/soc/nxp/imx/Kconfig.sysbuild"
osource "/home/mirafra/Girish/GITHUB/Zephyr_Workspace/zephyrproject/zephyr/soc/nuvoton/numicro/Kconfig.sysbuild"
osource "/home/mirafra/Girish/GITHUB/Zephyr_Workspace/zephyrproject/zephyr/soc/nuvoton/numaker/Kconfig.sysbuild"
osource "/home/mirafra/Girish/GITHUB/Zephyr_Workspace/zephyrproject/zephyr/soc/nuvoton/npcx/Kconfig.sysbuild"
osource "/home/mirafra/Girish/GITHUB/Zephyr_Workspace/zephyrproject/zephyr/soc/nuvoton/npcm/Kconfig.sysbuild"
osource "/home/mirafra/Girish/GITHUB/Zephyr_Workspace/zephyrproject/zephyr/soc/nordic/Kconfig.sysbuild"
osource "/home/mirafra/Girish/GITHUB/Zephyr_Workspace/zephyrproject/zephyr/soc/neorv32/Kconfig.sysbuild"
osource "/home/mirafra/Girish/GITHUB/Zephyr_Workspace/zephyrproject/zephyr/soc/native/inf_clock/Kconfig.sysbuild"
osource "/home/mirafra/Girish/GITHUB/Zephyr_Workspace/zephyrproject/zephyr/soc/microchip/smartfusion2/Kconfig.sysbuild"
osource "/home/mirafra/Girish/GITHUB/Zephyr_Workspace/zephyrproject/zephyr/soc/microchip/sam/sama7/Kconfig.sysbuild"
osource "/home/mirafra/Girish/GITHUB/Zephyr_Workspace/zephyrproject/zephyr/soc/microchip/sam/sama5/Kconfig.sysbuild"
osource "/home/mirafra/Girish/GITHUB/Zephyr_Workspace/zephyrproject/zephyr/soc/microchip/sam/sam_d5x_e5x/Kconfig.sysbuild"
osource "/home/mirafra/Girish/GITHUB/Zephyr_Workspace/zephyrproject/zephyr/soc/microchip/polarfire/Kconfig.sysbuild"
osource "/home/mirafra/Girish/GITHUB/Zephyr_Workspace/zephyrproject/zephyr/soc/microchip/pic64/Kconfig.sysbuild"
osource "/home/mirafra/Girish/GITHUB/Zephyr_Workspace/zephyrproject/zephyr/soc/microchip/pic32c/pic32cz_ca/Kconfig.sysbuild"
osource "/home/mirafra/Girish/GITHUB/Zephyr_Workspace/zephyrproject/zephyr/soc/microchip/pic32c/pic32cx_sg/Kconfig.sysbuild"
osource "/home/mirafra/Girish/GITHUB/Zephyr_Workspace/zephyrproject/zephyr/soc/microchip/pic32c/pic32cm_sg_gc/Kconfig.sysbuild"
osource "/home/mirafra/Girish/GITHUB/Zephyr_Workspace/zephyrproject/zephyr/soc/microchip/pic32c/pic32cm_pl/Kconfig.sysbuild"
osource "/home/mirafra/Girish/GITHUB/Zephyr_Workspace/zephyrproject/zephyr/soc/microchip/pic32c/pic32cm_jh/Kconfig.sysbuild"
osource "/home/mirafra/Girish/GITHUB/Zephyr_Workspace/zephyrproject/zephyr/soc/microchip/pic32c/pic32ck_sg_gc/Kconfig.sysbuild"
osource "/home/mirafra/Girish/GITHUB/Zephyr_Workspace/zephyrproject/zephyr/soc/microchip/miv/Kconfig.sysbuild"
osource "/home/mirafra/Girish/GITHUB/Zephyr_Workspace/zephyrproject/zephyr/soc/microchip/mec/Kconfig.sysbuild"
osource "/home/mirafra/Girish/GITHUB/Zephyr_Workspace/zephyrproject/zephyr/soc/mediatek/mt8xxx/Kconfig.sysbuild"
osource "/home/mirafra/Girish/GITHUB/Zephyr_Workspace/zephyrproject/zephyr/soc/lowrisc/opentitan/Kconfig.sysbuild"
osource "/home/mirafra/Girish/GITHUB/Zephyr_Workspace/zephyrproject/zephyr/soc/litex/Kconfig.sysbuild"
osource "/home/mirafra/Girish/GITHUB/Zephyr_Workspace/zephyrproject/zephyr/soc/ite/ec/Kconfig.sysbuild"
osource "/home/mirafra/Girish/GITHUB/Zephyr_Workspace/zephyrproject/zephyr/soc/intel/wildcat_lake/Kconfig.sysbuild"
osource "/home/mirafra/Girish/GITHUB/Zephyr_Workspace/zephyrproject/zephyr/soc/intel/raptor_lake/Kconfig.sysbuild"
osource "/home/mirafra/Girish/GITHUB/Zephyr_Workspace/zephyrproject/zephyr/soc/intel/panther_lake/Kconfig.sysbuild"
osource "/home/mirafra/Girish/GITHUB/Zephyr_Workspace/zephyrproject/zephyr/soc/intel/nova_lake/Kconfig.sysbuild"
osource "/home/mirafra/Girish/GITHUB/Zephyr_Workspace/zephyrproject/zephyr/soc/intel/lakemont/Kconfig.sysbuild"
osource "/home/mirafra/Girish/GITHUB/Zephyr_Workspace/zephyrproject/zephyr/soc/intel/intel_socfpga_std/Kconfig.sysbuild"
osource "/home/mirafra/Girish/GITHUB/Zephyr_Workspace/zephyrproject/zephyr/soc/intel/intel_socfpga/Kconfig.sysbuild"
osource "/home/mirafra/Girish/GITHUB/Zephyr_Workspace/zephyrproject/zephyr/soc/intel/intel_niosv/Kconfig.sysbuild"
osource "/home/mirafra/Girish/GITHUB/Zephyr_Workspace/zephyrproject/zephyr/soc/intel/intel_ish/Kconfig.sysbuild"
osource "/home/mirafra/Girish/GITHUB/Zephyr_Workspace/zephyrproject/zephyr/soc/intel/intel_adsp/Kconfig.sysbuild"
osource "/home/mirafra/Girish/GITHUB/Zephyr_Workspace/zephyrproject/zephyr/soc/intel/elkhart_lake/Kconfig.sysbuild"
osource "/home/mirafra/Girish/GITHUB/Zephyr_Workspace/zephyrproject/zephyr/soc/intel/atom/Kconfig.sysbuild"
osource "/home/mirafra/Girish/GITHUB/Zephyr_Workspace/zephyrproject/zephyr/soc/intel/apollo_lake/Kconfig.sysbuild"
osource "/home/mirafra/Girish/GITHUB/Zephyr_Workspace/zephyrproject/zephyr/soc/intel/alder_lake/Kconfig.sysbuild"
osource "/home/mirafra/Girish/GITHUB/Zephyr_Workspace/zephyrproject/zephyr/soc/infineon/psoc4/Kconfig.sysbuild"
osource "/home/mirafra/Girish/GITHUB/Zephyr_Workspace/zephyrproject/zephyr/soc/infineon/edge/Kconfig.sysbuild"
osource "/home/mirafra/Girish/GITHUB/Zephyr_Workspace/zephyrproject/zephyr/soc/infineon/cat3/Kconfig.sysbuild"
osource "/home/mirafra/Girish/GITHUB/Zephyr_Workspace/zephyrproject/zephyr/soc/infineon/cat1c/Kconfig.sysbuild"
osource "/home/mirafra/Girish/GITHUB/Zephyr_Workspace/zephyrproject/zephyr/soc/infineon/cat1b/Kconfig.sysbuild"
osource "/home/mirafra/Girish/GITHUB/Zephyr_Workspace/zephyrproject/zephyr/soc/infineon/cat1a/Kconfig.sysbuild"
osource "/home/mirafra/Girish/GITHUB/Zephyr_Workspace/zephyrproject/zephyr/soc/gd/gd32/Kconfig.sysbuild"
osource "/home/mirafra/Girish/GITHUB/Zephyr_Workspace/zephyrproject/zephyr/soc/gaisler/leon3/Kconfig.sysbuild"
osource "/home/mirafra/Girish/GITHUB/Zephyr_Workspace/zephyrproject/zephyr/soc/gaisler/gr716a/Kconfig.sysbuild"
osource "/home/mirafra/Girish/GITHUB/Zephyr_Workspace/zephyrproject/zephyr/soc/focaltech/Kconfig.sysbuild"
osource "/home/mirafra/Girish/GITHUB/Zephyr_Workspace/zephyrproject/zephyr/soc/espressif/Kconfig.sysbuild"
osource "/home/mirafra/Girish/GITHUB/Zephyr_Workspace/zephyrproject/zephyr/soc/ene/kb1200/Kconfig.sysbuild"
osource "/home/mirafra/Girish/GITHUB/Zephyr_Workspace/zephyrproject/zephyr/soc/ene/kb106x/Kconfig.sysbuild"
osource "/home/mirafra/Girish/GITHUB/Zephyr_Workspace/zephyrproject/zephyr/soc/elan/em32f967/Kconfig.sysbuild"
osource "/home/mirafra/Girish/GITHUB/Zephyr_Workspace/zephyrproject/zephyr/soc/egis/Kconfig.sysbuild"
osource "/home/mirafra/Girish/GITHUB/Zephyr_Workspace/zephyrproject/zephyr/soc/efinix/sapphire/Kconfig.sysbuild"
osource "/home/mirafra/Girish/GITHUB/Zephyr_Workspace/zephyrproject/zephyr/soc/cdns/xtensa_sample_controller/Kconfig.sysbuild"
osource "/home/mirafra/Girish/GITHUB/Zephyr_Workspace/zephyrproject/zephyr/soc/cdns/swerv/Kconfig.sysbuild"
osource "/home/mirafra/Girish/GITHUB/Zephyr_Workspace/zephyrproject/zephyr/soc/cdns/sample_controller32/Kconfig.sysbuild"
osource "/home/mirafra/Girish/GITHUB/Zephyr_Workspace/zephyrproject/zephyr/soc/cdns/dc233c/Kconfig.sysbuild"
osource "/home/mirafra/Girish/GITHUB/Zephyr_Workspace/zephyrproject/zephyr/soc/cdac/Kconfig.sysbuild"
osource "/home/mirafra/Girish/GITHUB/Zephyr_Workspace/zephyrproject/zephyr/soc/brcm/bcmvk/Kconfig.sysbuild"
osource "/home/mirafra/Girish/GITHUB/Zephyr_Workspace/zephyrproject/zephyr/soc/brcm/bcm2712/Kconfig.sysbuild"
osource "/home/mirafra/Girish/GITHUB/Zephyr_Workspace/zephyrproject/zephyr/soc/brcm/bcm2711/Kconfig.sysbuild"
osource "/home/mirafra/Girish/GITHUB/Zephyr_Workspace/zephyrproject/zephyr/soc/brcm/bcm2710/Kconfig.sysbuild"
osource "/home/mirafra/Girish/GITHUB/Zephyr_Workspace/zephyrproject/zephyr/soc/blackberry/qnxhv_vm/Kconfig.sysbuild"
osource "/home/mirafra/Girish/GITHUB/Zephyr_Workspace/zephyrproject/zephyr/soc/bflb/Kconfig.sysbuild"
osource "/home/mirafra/Girish/GITHUB/Zephyr_Workspace/zephyrproject/zephyr/soc/atmel/sam0/Kconfig.sysbuild"
osource "/home/mirafra/Girish/GITHUB/Zephyr_Workspace/zephyrproject/zephyr/soc/atmel/sam/Kconfig.sysbuild"
osource "/home/mirafra/Girish/GITHUB/Zephyr_Workspace/zephyrproject/zephyr/soc/aspeed/Kconfig.sysbuild"
osource "/home/mirafra/Girish/GITHUB/Zephyr_Workspace/zephyrproject/zephyr/soc/arm/Kconfig.sysbuild"
osource "/home/mirafra/Girish/GITHUB/Zephyr_Workspace/zephyrproject/zephyr/soc/antmicro/myra/Kconfig.sysbuild"
osource "/home/mirafra/Girish/GITHUB/Zephyr_Workspace/zephyrproject/zephyr/soc/andestech/Kconfig.sysbuild"
osource "/home/mirafra/Girish/GITHUB/Zephyr_Workspace/zephyrproject/zephyr/soc/amd/acp_7_x/Kconfig.sysbuild"
osource "/home/mirafra/Girish/GITHUB/Zephyr_Workspace/zephyrproject/zephyr/soc/amd/acp_7_0/Kconfig.sysbuild"
osource "/home/mirafra/Girish/GITHUB/Zephyr_Workspace/zephyrproject/zephyr/soc/amd/acp_6_0/Kconfig.sysbuild"
osource "/home/mirafra/Girish/GITHUB/Zephyr_Workspace/zephyrproject/zephyr/soc/ambiq/Kconfig.sysbuild"
osource "/home/mirafra/Girish/GITHUB/Zephyr_Workspace/zephyrproject/zephyr/soc/allwinner/sun8i_h3/Kconfig.sysbuild"
osource "/home/mirafra/Girish/GITHUB/Zephyr_Workspace/zephyrproject/zephyr/soc/allwinner/sun50i_h618/Kconfig.sysbuild"
osource "/home/mirafra/Girish/GITHUB/Zephyr_Workspace/zephyrproject/zephyr/soc/alif/ensemble/Kconfig.sysbuild"
osource "/home/mirafra/Girish/GITHUB/Zephyr_Workspace/zephyrproject/zephyr/soc/alif/balletto/Kconfig.sysbuild"
osource "/home/mirafra/Girish/GITHUB/Zephyr_Workspace/zephyrproject/zephyr/soc/aesc/Kconfig.sysbuild"
osource "/home/mirafra/Girish/GITHUB/Zephyr_Workspace/zephyrproject/zephyr/soc/adi/max32/Kconfig.sysbuild"
```
