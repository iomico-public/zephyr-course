## twister-out/native_sim_native/host_gnu/zephyr-course-stm32-c562re/tests/ring_buf/homework.unit.ring_buf/Kconfig/soc/Kconfig.soc
```kconfig
# Load SoC Kconfig descriptions.
osource "/home/mirafra/Girish/GITHUB/Zephyr_Workspace/zephyrproject/zephyr/soc/xlnx/zynqmp/Kconfig.soc"
osource "/home/mirafra/Girish/GITHUB/Zephyr_Workspace/zephyrproject/zephyr/soc/xlnx/zynq7000/Kconfig.soc"
osource "/home/mirafra/Girish/GITHUB/Zephyr_Workspace/zephyrproject/zephyr/soc/xlnx/versalnet/Kconfig.soc"
osource "/home/mirafra/Girish/GITHUB/Zephyr_Workspace/zephyrproject/zephyr/soc/xlnx/versal2/Kconfig.soc"
osource "/home/mirafra/Girish/GITHUB/Zephyr_Workspace/zephyrproject/zephyr/soc/xlnx/versal/Kconfig.soc"
osource "/home/mirafra/Girish/GITHUB/Zephyr_Workspace/zephyrproject/zephyr/soc/xen/Kconfig.soc"
osource "/home/mirafra/Girish/GITHUB/Zephyr_Workspace/zephyrproject/zephyr/soc/wch/ch32v/Kconfig.soc"
osource "/home/mirafra/Girish/GITHUB/Zephyr_Workspace/zephyrproject/zephyr/soc/ti/tiva_c/Kconfig.soc"
osource "/home/mirafra/Girish/GITHUB/Zephyr_Workspace/zephyrproject/zephyr/soc/ti/simplelink/Kconfig.soc"
osource "/home/mirafra/Girish/GITHUB/Zephyr_Workspace/zephyrproject/zephyr/soc/ti/mspm/Kconfig.soc"
osource "/home/mirafra/Girish/GITHUB/Zephyr_Workspace/zephyrproject/zephyr/soc/ti/lm3s6965/Kconfig.soc"
osource "/home/mirafra/Girish/GITHUB/Zephyr_Workspace/zephyrproject/zephyr/soc/ti/k3/Kconfig.soc"
osource "/home/mirafra/Girish/GITHUB/Zephyr_Workspace/zephyrproject/zephyr/soc/ti/am13/Kconfig.soc"
osource "/home/mirafra/Girish/GITHUB/Zephyr_Workspace/zephyrproject/zephyr/soc/telink/tlsr/Kconfig.soc"
osource "/home/mirafra/Girish/GITHUB/Zephyr_Workspace/zephyrproject/zephyr/soc/syna/sr100/Kconfig.soc"
osource "/home/mirafra/Girish/GITHUB/Zephyr_Workspace/zephyrproject/zephyr/soc/starfive/jh71xx/Kconfig.soc"
osource "/home/mirafra/Girish/GITHUB/Zephyr_Workspace/zephyrproject/zephyr/soc/st/stm32/Kconfig.soc"
osource "/home/mirafra/Girish/GITHUB/Zephyr_Workspace/zephyrproject/zephyr/soc/snps/qemu_arc/Kconfig.soc"
osource "/home/mirafra/Girish/GITHUB/Zephyr_Workspace/zephyrproject/zephyr/soc/snps/nsim/arc_v/Kconfig.soc"
osource "/home/mirafra/Girish/GITHUB/Zephyr_Workspace/zephyrproject/zephyr/soc/snps/nsim/arc_classic/Kconfig.soc"
osource "/home/mirafra/Girish/GITHUB/Zephyr_Workspace/zephyrproject/zephyr/soc/snps/hsdk4xd/Kconfig.soc"
osource "/home/mirafra/Girish/GITHUB/Zephyr_Workspace/zephyrproject/zephyr/soc/snps/hsdk/Kconfig.soc"
osource "/home/mirafra/Girish/GITHUB/Zephyr_Workspace/zephyrproject/zephyr/soc/snps/emsk/Kconfig.soc"
osource "/home/mirafra/Girish/GITHUB/Zephyr_Workspace/zephyrproject/zephyr/soc/snps/emsdp/Kconfig.soc"
osource "/home/mirafra/Girish/GITHUB/Zephyr_Workspace/zephyrproject/zephyr/soc/snps/arc_iot/Kconfig.soc"
osource "/home/mirafra/Girish/GITHUB/Zephyr_Workspace/zephyrproject/zephyr/soc/silabs/Kconfig.soc"
osource "/home/mirafra/Girish/GITHUB/Zephyr_Workspace/zephyrproject/zephyr/soc/sifli/sf32/Kconfig.soc"
osource "/home/mirafra/Girish/GITHUB/Zephyr_Workspace/zephyrproject/zephyr/soc/sifive/sifive_freedom/Kconfig.soc"
osource "/home/mirafra/Girish/GITHUB/Zephyr_Workspace/zephyrproject/zephyr/soc/shakti/Kconfig.soc"
osource "/home/mirafra/Girish/GITHUB/Zephyr_Workspace/zephyrproject/zephyr/soc/sensry/Kconfig.soc"
osource "/home/mirafra/Girish/GITHUB/Zephyr_Workspace/zephyrproject/zephyr/soc/rockchip/Kconfig.soc"
osource "/home/mirafra/Girish/GITHUB/Zephyr_Workspace/zephyrproject/zephyr/soc/renode/riscv_virtual/Kconfig.soc"
osource "/home/mirafra/Girish/GITHUB/Zephyr_Workspace/zephyrproject/zephyr/soc/renode/cortex_r8_virtual/Kconfig.soc"
osource "/home/mirafra/Girish/GITHUB/Zephyr_Workspace/zephyrproject/zephyr/soc/renesas/smartbond/Kconfig.soc"
osource "/home/mirafra/Girish/GITHUB/Zephyr_Workspace/zephyrproject/zephyr/soc/renesas/rz/Kconfig.soc"
osource "/home/mirafra/Girish/GITHUB/Zephyr_Workspace/zephyrproject/zephyr/soc/renesas/rx/Kconfig.soc"
osource "/home/mirafra/Girish/GITHUB/Zephyr_Workspace/zephyrproject/zephyr/soc/renesas/rcar/Kconfig.soc"
osource "/home/mirafra/Girish/GITHUB/Zephyr_Workspace/zephyrproject/zephyr/soc/renesas/ra/Kconfig.soc"
osource "/home/mirafra/Girish/GITHUB/Zephyr_Workspace/zephyrproject/zephyr/soc/realtek/fingerprint/Kconfig.soc"
osource "/home/mirafra/Girish/GITHUB/Zephyr_Workspace/zephyrproject/zephyr/soc/realtek/ec/Kconfig.soc"
osource "/home/mirafra/Girish/GITHUB/Zephyr_Workspace/zephyrproject/zephyr/soc/realtek/bee/Kconfig.soc"
osource "/home/mirafra/Girish/GITHUB/Zephyr_Workspace/zephyrproject/zephyr/soc/realtek/ameba/Kconfig.soc"
osource "/home/mirafra/Girish/GITHUB/Zephyr_Workspace/zephyrproject/zephyr/soc/raspberrypi/rpi_pico/Kconfig.soc"
osource "/home/mirafra/Girish/GITHUB/Zephyr_Workspace/zephyrproject/zephyr/soc/quicklogic/eos_s3/Kconfig.soc"
osource "/home/mirafra/Girish/GITHUB/Zephyr_Workspace/zephyrproject/zephyr/soc/qemu/virt_riscv/Kconfig.soc"
osource "/home/mirafra/Girish/GITHUB/Zephyr_Workspace/zephyrproject/zephyr/soc/qemu/tricore/Kconfig.soc"
osource "/home/mirafra/Girish/GITHUB/Zephyr_Workspace/zephyrproject/zephyr/soc/qemu/or1k/Kconfig.soc"
osource "/home/mirafra/Girish/GITHUB/Zephyr_Workspace/zephyrproject/zephyr/soc/qemu/malta/Kconfig.soc"
osource "/home/mirafra/Girish/GITHUB/Zephyr_Workspace/zephyrproject/zephyr/soc/qemu/hexagon/Kconfig.soc"
osource "/home/mirafra/Girish/GITHUB/Zephyr_Workspace/zephyrproject/zephyr/soc/openisa/rv32m1/Kconfig.soc"
osource "/home/mirafra/Girish/GITHUB/Zephyr_Workspace/zephyrproject/zephyr/soc/openhwgroup/erbium/Kconfig.soc"
osource "/home/mirafra/Girish/GITHUB/Zephyr_Workspace/zephyrproject/zephyr/soc/openhwgroup/cva6/Kconfig.soc"
osource "/home/mirafra/Girish/GITHUB/Zephyr_Workspace/zephyrproject/zephyr/soc/oct/osd32mp15x/Kconfig.soc"
osource "/home/mirafra/Girish/GITHUB/Zephyr_Workspace/zephyrproject/zephyr/soc/nxp/s32/Kconfig.soc"
osource "/home/mirafra/Girish/GITHUB/Zephyr_Workspace/zephyrproject/zephyr/soc/nxp/rw/Kconfig.soc"
osource "/home/mirafra/Girish/GITHUB/Zephyr_Workspace/zephyrproject/zephyr/soc/nxp/mcx/Kconfig.soc"
osource "/home/mirafra/Girish/GITHUB/Zephyr_Workspace/zephyrproject/zephyr/soc/nxp/lpc/Kconfig.soc"
osource "/home/mirafra/Girish/GITHUB/Zephyr_Workspace/zephyrproject/zephyr/soc/nxp/layerscape/Kconfig.soc"
osource "/home/mirafra/Girish/GITHUB/Zephyr_Workspace/zephyrproject/zephyr/soc/nxp/kinetis/Kconfig.soc"
osource "/home/mirafra/Girish/GITHUB/Zephyr_Workspace/zephyrproject/zephyr/soc/nxp/imxrt/Kconfig.soc"
osource "/home/mirafra/Girish/GITHUB/Zephyr_Workspace/zephyrproject/zephyr/soc/nxp/imx/Kconfig.soc"
osource "/home/mirafra/Girish/GITHUB/Zephyr_Workspace/zephyrproject/zephyr/soc/nuvoton/numicro/Kconfig.soc"
osource "/home/mirafra/Girish/GITHUB/Zephyr_Workspace/zephyrproject/zephyr/soc/nuvoton/numaker/Kconfig.soc"
osource "/home/mirafra/Girish/GITHUB/Zephyr_Workspace/zephyrproject/zephyr/soc/nuvoton/npcx/Kconfig.soc"
osource "/home/mirafra/Girish/GITHUB/Zephyr_Workspace/zephyrproject/zephyr/soc/nuvoton/npcm/Kconfig.soc"
osource "/home/mirafra/Girish/GITHUB/Zephyr_Workspace/zephyrproject/zephyr/soc/nordic/Kconfig.soc"
osource "/home/mirafra/Girish/GITHUB/Zephyr_Workspace/zephyrproject/zephyr/soc/neorv32/Kconfig.soc"
osource "/home/mirafra/Girish/GITHUB/Zephyr_Workspace/zephyrproject/zephyr/soc/native/inf_clock/Kconfig.soc"
osource "/home/mirafra/Girish/GITHUB/Zephyr_Workspace/zephyrproject/zephyr/soc/microchip/smartfusion2/Kconfig.soc"
osource "/home/mirafra/Girish/GITHUB/Zephyr_Workspace/zephyrproject/zephyr/soc/microchip/sam/sama7/Kconfig.soc"
osource "/home/mirafra/Girish/GITHUB/Zephyr_Workspace/zephyrproject/zephyr/soc/microchip/sam/sama5/Kconfig.soc"
osource "/home/mirafra/Girish/GITHUB/Zephyr_Workspace/zephyrproject/zephyr/soc/microchip/sam/sam_d5x_e5x/Kconfig.soc"
osource "/home/mirafra/Girish/GITHUB/Zephyr_Workspace/zephyrproject/zephyr/soc/microchip/polarfire/Kconfig.soc"
osource "/home/mirafra/Girish/GITHUB/Zephyr_Workspace/zephyrproject/zephyr/soc/microchip/pic64/Kconfig.soc"
osource "/home/mirafra/Girish/GITHUB/Zephyr_Workspace/zephyrproject/zephyr/soc/microchip/pic32c/pic32cz_ca/Kconfig.soc"
osource "/home/mirafra/Girish/GITHUB/Zephyr_Workspace/zephyrproject/zephyr/soc/microchip/pic32c/pic32cx_sg/Kconfig.soc"
osource "/home/mirafra/Girish/GITHUB/Zephyr_Workspace/zephyrproject/zephyr/soc/microchip/pic32c/pic32cm_sg_gc/Kconfig.soc"
osource "/home/mirafra/Girish/GITHUB/Zephyr_Workspace/zephyrproject/zephyr/soc/microchip/pic32c/pic32cm_pl/Kconfig.soc"
osource "/home/mirafra/Girish/GITHUB/Zephyr_Workspace/zephyrproject/zephyr/soc/microchip/pic32c/pic32cm_jh/Kconfig.soc"
osource "/home/mirafra/Girish/GITHUB/Zephyr_Workspace/zephyrproject/zephyr/soc/microchip/pic32c/pic32ck_sg_gc/Kconfig.soc"
osource "/home/mirafra/Girish/GITHUB/Zephyr_Workspace/zephyrproject/zephyr/soc/microchip/miv/Kconfig.soc"
osource "/home/mirafra/Girish/GITHUB/Zephyr_Workspace/zephyrproject/zephyr/soc/microchip/mec/Kconfig.soc"
osource "/home/mirafra/Girish/GITHUB/Zephyr_Workspace/zephyrproject/zephyr/soc/mediatek/mt8xxx/Kconfig.soc"
osource "/home/mirafra/Girish/GITHUB/Zephyr_Workspace/zephyrproject/zephyr/soc/lowrisc/opentitan/Kconfig.soc"
osource "/home/mirafra/Girish/GITHUB/Zephyr_Workspace/zephyrproject/zephyr/soc/litex/Kconfig.soc"
osource "/home/mirafra/Girish/GITHUB/Zephyr_Workspace/zephyrproject/zephyr/soc/ite/ec/Kconfig.soc"
osource "/home/mirafra/Girish/GITHUB/Zephyr_Workspace/zephyrproject/zephyr/soc/intel/wildcat_lake/Kconfig.soc"
osource "/home/mirafra/Girish/GITHUB/Zephyr_Workspace/zephyrproject/zephyr/soc/intel/raptor_lake/Kconfig.soc"
osource "/home/mirafra/Girish/GITHUB/Zephyr_Workspace/zephyrproject/zephyr/soc/intel/panther_lake/Kconfig.soc"
osource "/home/mirafra/Girish/GITHUB/Zephyr_Workspace/zephyrproject/zephyr/soc/intel/nova_lake/Kconfig.soc"
osource "/home/mirafra/Girish/GITHUB/Zephyr_Workspace/zephyrproject/zephyr/soc/intel/lakemont/Kconfig.soc"
osource "/home/mirafra/Girish/GITHUB/Zephyr_Workspace/zephyrproject/zephyr/soc/intel/intel_socfpga_std/Kconfig.soc"
osource "/home/mirafra/Girish/GITHUB/Zephyr_Workspace/zephyrproject/zephyr/soc/intel/intel_socfpga/Kconfig.soc"
osource "/home/mirafra/Girish/GITHUB/Zephyr_Workspace/zephyrproject/zephyr/soc/intel/intel_niosv/Kconfig.soc"
osource "/home/mirafra/Girish/GITHUB/Zephyr_Workspace/zephyrproject/zephyr/soc/intel/intel_ish/Kconfig.soc"
osource "/home/mirafra/Girish/GITHUB/Zephyr_Workspace/zephyrproject/zephyr/soc/intel/intel_adsp/Kconfig.soc"
osource "/home/mirafra/Girish/GITHUB/Zephyr_Workspace/zephyrproject/zephyr/soc/intel/elkhart_lake/Kconfig.soc"
osource "/home/mirafra/Girish/GITHUB/Zephyr_Workspace/zephyrproject/zephyr/soc/intel/atom/Kconfig.soc"
osource "/home/mirafra/Girish/GITHUB/Zephyr_Workspace/zephyrproject/zephyr/soc/intel/apollo_lake/Kconfig.soc"
osource "/home/mirafra/Girish/GITHUB/Zephyr_Workspace/zephyrproject/zephyr/soc/intel/alder_lake/Kconfig.soc"
osource "/home/mirafra/Girish/GITHUB/Zephyr_Workspace/zephyrproject/zephyr/soc/infineon/psoc4/Kconfig.soc"
osource "/home/mirafra/Girish/GITHUB/Zephyr_Workspace/zephyrproject/zephyr/soc/infineon/edge/Kconfig.soc"
osource "/home/mirafra/Girish/GITHUB/Zephyr_Workspace/zephyrproject/zephyr/soc/infineon/cat3/Kconfig.soc"
osource "/home/mirafra/Girish/GITHUB/Zephyr_Workspace/zephyrproject/zephyr/soc/infineon/cat1c/Kconfig.soc"
osource "/home/mirafra/Girish/GITHUB/Zephyr_Workspace/zephyrproject/zephyr/soc/infineon/cat1b/Kconfig.soc"
osource "/home/mirafra/Girish/GITHUB/Zephyr_Workspace/zephyrproject/zephyr/soc/infineon/cat1a/Kconfig.soc"
osource "/home/mirafra/Girish/GITHUB/Zephyr_Workspace/zephyrproject/zephyr/soc/gd/gd32/Kconfig.soc"
osource "/home/mirafra/Girish/GITHUB/Zephyr_Workspace/zephyrproject/zephyr/soc/gaisler/leon3/Kconfig.soc"
osource "/home/mirafra/Girish/GITHUB/Zephyr_Workspace/zephyrproject/zephyr/soc/gaisler/gr716a/Kconfig.soc"
osource "/home/mirafra/Girish/GITHUB/Zephyr_Workspace/zephyrproject/zephyr/soc/focaltech/Kconfig.soc"
osource "/home/mirafra/Girish/GITHUB/Zephyr_Workspace/zephyrproject/zephyr/soc/espressif/Kconfig.soc"
osource "/home/mirafra/Girish/GITHUB/Zephyr_Workspace/zephyrproject/zephyr/soc/ene/kb1200/Kconfig.soc"
osource "/home/mirafra/Girish/GITHUB/Zephyr_Workspace/zephyrproject/zephyr/soc/ene/kb106x/Kconfig.soc"
osource "/home/mirafra/Girish/GITHUB/Zephyr_Workspace/zephyrproject/zephyr/soc/elan/em32f967/Kconfig.soc"
osource "/home/mirafra/Girish/GITHUB/Zephyr_Workspace/zephyrproject/zephyr/soc/egis/Kconfig.soc"
osource "/home/mirafra/Girish/GITHUB/Zephyr_Workspace/zephyrproject/zephyr/soc/efinix/sapphire/Kconfig.soc"
osource "/home/mirafra/Girish/GITHUB/Zephyr_Workspace/zephyrproject/zephyr/soc/cdns/xtensa_sample_controller/Kconfig.soc"
osource "/home/mirafra/Girish/GITHUB/Zephyr_Workspace/zephyrproject/zephyr/soc/cdns/swerv/Kconfig.soc"
osource "/home/mirafra/Girish/GITHUB/Zephyr_Workspace/zephyrproject/zephyr/soc/cdns/sample_controller32/Kconfig.soc"
osource "/home/mirafra/Girish/GITHUB/Zephyr_Workspace/zephyrproject/zephyr/soc/cdns/dc233c/Kconfig.soc"
osource "/home/mirafra/Girish/GITHUB/Zephyr_Workspace/zephyrproject/zephyr/soc/cdac/Kconfig.soc"
osource "/home/mirafra/Girish/GITHUB/Zephyr_Workspace/zephyrproject/zephyr/soc/brcm/bcmvk/Kconfig.soc"
osource "/home/mirafra/Girish/GITHUB/Zephyr_Workspace/zephyrproject/zephyr/soc/brcm/bcm2712/Kconfig.soc"
osource "/home/mirafra/Girish/GITHUB/Zephyr_Workspace/zephyrproject/zephyr/soc/brcm/bcm2711/Kconfig.soc"
osource "/home/mirafra/Girish/GITHUB/Zephyr_Workspace/zephyrproject/zephyr/soc/brcm/bcm2710/Kconfig.soc"
osource "/home/mirafra/Girish/GITHUB/Zephyr_Workspace/zephyrproject/zephyr/soc/blackberry/qnxhv_vm/Kconfig.soc"
osource "/home/mirafra/Girish/GITHUB/Zephyr_Workspace/zephyrproject/zephyr/soc/bflb/Kconfig.soc"
osource "/home/mirafra/Girish/GITHUB/Zephyr_Workspace/zephyrproject/zephyr/soc/atmel/sam0/Kconfig.soc"
osource "/home/mirafra/Girish/GITHUB/Zephyr_Workspace/zephyrproject/zephyr/soc/atmel/sam/Kconfig.soc"
osource "/home/mirafra/Girish/GITHUB/Zephyr_Workspace/zephyrproject/zephyr/soc/aspeed/Kconfig.soc"
osource "/home/mirafra/Girish/GITHUB/Zephyr_Workspace/zephyrproject/zephyr/soc/arm/Kconfig.soc"
osource "/home/mirafra/Girish/GITHUB/Zephyr_Workspace/zephyrproject/zephyr/soc/antmicro/myra/Kconfig.soc"
osource "/home/mirafra/Girish/GITHUB/Zephyr_Workspace/zephyrproject/zephyr/soc/andestech/Kconfig.soc"
osource "/home/mirafra/Girish/GITHUB/Zephyr_Workspace/zephyrproject/zephyr/soc/amd/acp_7_x/Kconfig.soc"
osource "/home/mirafra/Girish/GITHUB/Zephyr_Workspace/zephyrproject/zephyr/soc/amd/acp_7_0/Kconfig.soc"
osource "/home/mirafra/Girish/GITHUB/Zephyr_Workspace/zephyrproject/zephyr/soc/amd/acp_6_0/Kconfig.soc"
osource "/home/mirafra/Girish/GITHUB/Zephyr_Workspace/zephyrproject/zephyr/soc/ambiq/Kconfig.soc"
osource "/home/mirafra/Girish/GITHUB/Zephyr_Workspace/zephyrproject/zephyr/soc/allwinner/sun8i_h3/Kconfig.soc"
osource "/home/mirafra/Girish/GITHUB/Zephyr_Workspace/zephyrproject/zephyr/soc/allwinner/sun50i_h618/Kconfig.soc"
osource "/home/mirafra/Girish/GITHUB/Zephyr_Workspace/zephyrproject/zephyr/soc/alif/ensemble/Kconfig.soc"
osource "/home/mirafra/Girish/GITHUB/Zephyr_Workspace/zephyrproject/zephyr/soc/alif/balletto/Kconfig.soc"
osource "/home/mirafra/Girish/GITHUB/Zephyr_Workspace/zephyrproject/zephyr/soc/aesc/Kconfig.soc"
osource "/home/mirafra/Girish/GITHUB/Zephyr_Workspace/zephyrproject/zephyr/soc/adi/max32/Kconfig.soc"
```
