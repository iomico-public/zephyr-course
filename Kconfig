## boards/custom_esp32s3/board.yml
```yaml
board:
  name: custom_esp32s3
  full_name: ESP32-S3-DevKitC
  vendor: espressif
  socs:
  - name: esp32s3
```

## drivers/sensor/led_sensor/Kconfig
```kconfig
config LED_SENSOR
	bool "Custom LED Sensor Driver"
	default y
	depends on DT_HAS_CUSTOM_LED_SENSOR_ENABLED
	select GPIO
	help
	  Enable the custom on-board LED sensor driver.
```

## dts/bindings/sensor/custom,led-sensor.yaml
```yaml
description: Simple on-board LED sensor driver

compatible: "custom,led-sensor"

include: sensor-device.yaml

properties:
  gpios:
    type: phandle-array
    required: true
    description: GPIO pin driving the on-board LED
```

## l5-task1/boards/custom_mcxn236/Kconfig.custom_mcxn236
```kconfig
# Copyright 2024 NXP
# SPDX-License-Identifier: Apache-2.0

config BOARD_CUSTOM_MCXN236	
	bool
	select SOC_MCXN236
	select SOC_PART_NUMBER_MCXN236VDF
```

## l5-task1/boards/custom_mcxn236/board.yml
```yaml
board:
  name: custom_mcxn236
  full_name: Custom MCXN236 Board
  vendor: nxp
  socs:
    - name: mcxn236
```

## l5-task2/boards/nxp/my_mcxn236/Kconfig.defconfig
```kconfig
if BOARD_MY_MCXN236

if BOOTLOADER_MCUBOOT
choice MCUBOOT_BOOTLOADER_MODE
	default MCUBOOT_BOOTLOADER_MODE_OVERWRITE_ONLY
endchoice
endif # BOOTLOADER_MCUBOOT

endif # BOARD_MY_MCXN236
```

## l5-task2/boards/nxp/my_mcxn236/Kconfig.my_mcxn236
```kconfig
config BOARD_MY_MCXN236
    select SOC_MCXN236
	select SOC_PART_NUMBER_MCXN236VDF
```

## l5-task2/boards/nxp/my_mcxn236/board.yml
```yaml
board:
  name: my_mcxn236
  full_name: Custom MCXN236 From Scratch Board
  vendor: nxp
  socs:
    - name: mcxn236
```

## l6-task1/drivers/sensor/Kconfig
```kconfig
menuconfig CUSTOM_LED_SENSOR
    bool "Custom LED Sensor Driver"
    default y
    depends on DT_HAS_CUSTOM_LED_SENSOR_ENABLED
	select SENSOR
    help
      Enable the Custom LED Sensor Driver.
```

## l7-task2/dts/bindings/custom,led-sensor.yaml
```yaml
description: Custom LED Sensor Driver binding
compatible: "custom,led-sensor"
include: base.yaml
properties:
  led-gpios:
    type: phandle-array
    required: true
```

## twister-out/native_sim_native/host_gnu/zephyr-course-stm32-c562re/tests/ring_buf/homework.unit.ring_buf/Kconfig/Kconfig.modules
```kconfig
menu "acpica (/home/mirafra/Girish/GITHUB/Zephyr_Workspace/zephyrproject/modules/lib/acpica)"
osource "$(ZEPHYR_ACPICA_KCONFIG)"
config ZEPHYR_ACPICA_MODULE
	bool
	default y
endmenu
menu "cmsis (/home/mirafra/Girish/GITHUB/Zephyr_Workspace/zephyrproject/modules/hal/cmsis)"
osource "$(ZEPHYR_CMSIS_KCONFIG)"
config ZEPHYR_CMSIS_MODULE
	bool
	default y
endmenu
menu "cmsis-dsp (/home/mirafra/Girish/GITHUB/Zephyr_Workspace/zephyrproject/modules/lib/cmsis-dsp)"
osource "/home/mirafra/Girish/GITHUB/Zephyr_Workspace/zephyrproject/modules/lib/cmsis-dsp/zephyr/Kconfig"
config ZEPHYR_CMSIS_DSP_MODULE
	bool
	default y
endmenu
menu "cmsis-nn (/home/mirafra/Girish/GITHUB/Zephyr_Workspace/zephyrproject/modules/lib/cmsis-nn)"
osource "$(ZEPHYR_CMSIS_NN_KCONFIG)"
config ZEPHYR_CMSIS_NN_MODULE
	bool
	default y
endmenu
menu "cmsis_6 (/home/mirafra/Girish/GITHUB/Zephyr_Workspace/zephyrproject/modules/hal/cmsis_6)"
osource "$(ZEPHYR_CMSIS_6_KCONFIG)"
config ZEPHYR_CMSIS_6_MODULE
	bool
	default y
endmenu
menu "dhara (/home/mirafra/Girish/GITHUB/Zephyr_Workspace/zephyrproject/modules/lib/dhara)"
osource "$(ZEPHYR_DHARA_KCONFIG)"
config ZEPHYR_DHARA_MODULE
	bool
	default y
endmenu
menu "fatfs (/home/mirafra/Girish/GITHUB/Zephyr_Workspace/zephyrproject/modules/fs/fatfs)"
osource "$(ZEPHYR_FATFS_KCONFIG)"
config ZEPHYR_FATFS_MODULE
	bool
	default y
endmenu
config ZEPHYR_ADI_MODULE
	bool
	default y
menu "hal_afbr (/home/mirafra/Girish/GITHUB/Zephyr_Workspace/zephyrproject/modules/hal/afbr)"
osource "$(ZEPHYR_HAL_AFBR_KCONFIG)"
config ZEPHYR_HAL_AFBR_MODULE
	bool
	default y

config ZEPHYR_HAL_AFBR_MODULE_BLOBS
	bool
endmenu
menu "hal_ambiq (/home/mirafra/Girish/GITHUB/Zephyr_Workspace/zephyrproject/modules/hal/ambiq)"
osource "$(ZEPHYR_HAL_AMBIQ_KCONFIG)"
config ZEPHYR_HAL_AMBIQ_MODULE
	bool
	default y
endmenu
config ZEPHYR_ATMEL_MODULE
	bool
	default y
menu "hal_bouffalolab (/home/mirafra/Girish/GITHUB/Zephyr_Workspace/zephyrproject/modules/hal/bouffalolab)"
osource "$(ZEPHYR_HAL_BOUFFALOLAB_KCONFIG)"
config ZEPHYR_HAL_BOUFFALOLAB_MODULE
	bool
	default y

config ZEPHYR_HAL_BOUFFALOLAB_MODULE_BLOBS
	bool
endmenu
menu "hal_espressif (/home/mirafra/Girish/GITHUB/Zephyr_Workspace/zephyrproject/modules/hal/espressif)"
osource "/home/mirafra/Girish/GITHUB/Zephyr_Workspace/zephyrproject/modules/hal/espressif/zephyr/Kconfig"
config ZEPHYR_HAL_ESPRESSIF_MODULE
	bool
	default y

config ZEPHYR_HAL_ESPRESSIF_MODULE_BLOBS
	bool
endmenu
menu "hal_ethos_u (/home/mirafra/Girish/GITHUB/Zephyr_Workspace/zephyrproject/modules/hal/ethos_u)"
osource "$(ZEPHYR_HAL_ETHOS_U_KCONFIG)"
config ZEPHYR_HAL_ETHOS_U_MODULE
	bool
	default y
endmenu
menu "hal_gigadevice (/home/mirafra/Girish/GITHUB/Zephyr_Workspace/zephyrproject/modules/hal/gigadevice)"
osource "$(ZEPHYR_HAL_GIGADEVICE_KCONFIG)"
config ZEPHYR_HAL_GIGADEVICE_MODULE
	bool
	default y
endmenu
menu "hal_infineon (/home/mirafra/Girish/GITHUB/Zephyr_Workspace/zephyrproject/modules/hal/infineon)"
osource "$(ZEPHYR_HAL_INFINEON_KCONFIG)"
config ZEPHYR_HAL_INFINEON_MODULE
	bool
	default y

config ZEPHYR_HAL_INFINEON_MODULE_BLOBS
	bool
endmenu
menu "hal_intel (/home/mirafra/Girish/GITHUB/Zephyr_Workspace/zephyrproject/modules/hal/intel)"
osource "/home/mirafra/Girish/GITHUB/Zephyr_Workspace/zephyrproject/modules/hal/intel/zephyr/Kconfig"
config ZEPHYR_HAL_INTEL_MODULE
	bool
	default y
endmenu
config ZEPHYR_HAL_MICROCHIP_MODULE
	bool
	default y

config ZEPHYR_HAL_MICROCHIP_MODULE_BLOBS
	bool
menu "hal_nordic (/home/mirafra/Girish/GITHUB/Zephyr_Workspace/zephyrproject/modules/hal/nordic)"
osource "$(ZEPHYR_HAL_NORDIC_KCONFIG)"
config ZEPHYR_HAL_NORDIC_MODULE
	bool
	default y

config ZEPHYR_HAL_NORDIC_MODULE_BLOBS
	bool
endmenu
config ZEPHYR_NUVOTON_MODULE
	bool
	default y
menu "hal_nxp (/home/mirafra/Girish/GITHUB/Zephyr_Workspace/zephyrproject/modules/hal/nxp)"
osource "$(ZEPHYR_HAL_NXP_KCONFIG)"
config ZEPHYR_HAL_NXP_MODULE
	bool
	default y

config ZEPHYR_HAL_NXP_MODULE_BLOBS
	bool
endmenu
config ZEPHYR_OPENISA_MODULE
	bool
	default y
config ZEPHYR_QUICKLOGIC_MODULE
	bool
	default y
menu "hal_realtek (/home/mirafra/Girish/GITHUB/Zephyr_Workspace/zephyrproject/modules/hal/realtek)"
osource "$(ZEPHYR_HAL_REALTEK_KCONFIG)"
config ZEPHYR_HAL_REALTEK_MODULE
	bool
	default y

config ZEPHYR_HAL_REALTEK_MODULE_BLOBS
	bool
endmenu
config ZEPHYR_HAL_RENESAS_MODULE
	bool
	default y

config ZEPHYR_HAL_RENESAS_MODULE_BLOBS
	bool
menu "hal_rpi_pico (/home/mirafra/Girish/GITHUB/Zephyr_Workspace/zephyrproject/modules/hal/rpi_pico)"
osource "$(ZEPHYR_HAL_RPI_PICO_KCONFIG)"
config ZEPHYR_HAL_RPI_PICO_MODULE
	bool
	default y
endmenu
menu "hal_sifli (/home/mirafra/Girish/GITHUB/Zephyr_Workspace/zephyrproject/modules/hal/sifli)"
osource "$(ZEPHYR_HAL_SIFLI_KCONFIG)"
config ZEPHYR_HAL_SIFLI_MODULE
	bool
	default y

config ZEPHYR_HAL_SIFLI_MODULE_BLOBS
	bool
endmenu
menu "hal_silabs (/home/mirafra/Girish/GITHUB/Zephyr_Workspace/zephyrproject/modules/hal/silabs)"
osource "$(ZEPHYR_HAL_SILABS_KCONFIG)"
config ZEPHYR_HAL_SILABS_MODULE
	bool
	default y

config ZEPHYR_HAL_SILABS_MODULE_BLOBS
	bool
endmenu
menu "hal_st (/home/mirafra/Girish/GITHUB/Zephyr_Workspace/zephyrproject/modules/hal/st)"
osource "$(ZEPHYR_HAL_ST_KCONFIG)"
config ZEPHYR_HAL_ST_MODULE
	bool
	default y

config ZEPHYR_HAL_ST_MODULE_BLOBS
	bool
endmenu
config ZEPHYR_HAL_STM32_MODULE
	bool
	default y

config ZEPHYR_HAL_STM32_MODULE_BLOBS
	bool
menu "hal_tdk (/home/mirafra/Girish/GITHUB/Zephyr_Workspace/zephyrproject/modules/hal/tdk)"
osource "$(ZEPHYR_HAL_TDK_KCONFIG)"
config ZEPHYR_HAL_TDK_MODULE
	bool
	default y
endmenu
menu "hal_telink (/home/mirafra/Girish/GITHUB/Zephyr_Workspace/zephyrproject/modules/hal/telink)"
osource "/home/mirafra/Girish/GITHUB/Zephyr_Workspace/zephyrproject/modules/hal/telink/Kconfig"
config ZEPHYR_HAL_TELINK_MODULE
	bool
	default y
endmenu
config ZEPHYR_TI_MODULE
	bool
	default y
menu "hal_wch (/home/mirafra/Girish/GITHUB/Zephyr_Workspace/zephyrproject/modules/hal/wch)"
osource "$(ZEPHYR_HAL_WCH_KCONFIG)"
config ZEPHYR_HAL_WCH_MODULE
	bool
	default y
endmenu
config ZEPHYR_HAL_WURTHELEKTRONIK_MODULE
	bool
	default y
config ZEPHYR_XTENSA_MODULE
	bool
	default y
menu "hostap (/home/mirafra/Girish/GITHUB/Zephyr_Workspace/zephyrproject/modules/lib/hostap)"
osource "$(ZEPHYR_HOSTAP_KCONFIG)"
config ZEPHYR_HOSTAP_MODULE
	bool
	default y
endmenu
menu "liblc3 (/home/mirafra/Girish/GITHUB/Zephyr_Workspace/zephyrproject/modules/lib/liblc3)"
osource "$(ZEPHYR_LIBLC3_KCONFIG)"
config ZEPHYR_LIBLC3_MODULE
	bool
	default y
endmenu
config ZEPHYR_LIBMCTP_MODULE
	bool
	default y
config ZEPHYR_LIBMETAL_MODULE
	bool
	default y
menu "libsbc (/home/mirafra/Girish/GITHUB/Zephyr_Workspace/zephyrproject/modules/lib/libsbc)"
osource "$(ZEPHYR_LIBSBC_KCONFIG)"
config ZEPHYR_LIBSBC_MODULE
	bool
	default y
endmenu
menu "littlefs (/home/mirafra/Girish/GITHUB/Zephyr_Workspace/zephyrproject/modules/fs/littlefs)"
osource "$(ZEPHYR_LITTLEFS_KCONFIG)"
config ZEPHYR_LITTLEFS_MODULE
	bool
	default y
endmenu
menu "lora-basics-modem (/home/mirafra/Girish/GITHUB/Zephyr_Workspace/zephyrproject/modules/lib/lora-basics-modem)"
osource "$(ZEPHYR_LORA_BASICS_MODEM_KCONFIG)"
config ZEPHYR_LORA_BASICS_MODEM_MODULE
	bool
	default y
endmenu
menu "loramac-node (/home/mirafra/Girish/GITHUB/Zephyr_Workspace/zephyrproject/modules/lib/loramac-node)"
osource "$(ZEPHYR_LORAMAC_NODE_KCONFIG)"
config ZEPHYR_LORAMAC_NODE_MODULE
	bool
	default y
endmenu
menu "lvgl (/home/mirafra/Girish/GITHUB/Zephyr_Workspace/zephyrproject/modules/lib/gui/lvgl)"
osource "/home/mirafra/Girish/GITHUB/Zephyr_Workspace/zephyrproject/modules/lib/gui/lvgl/zephyr/Kconfig"
config ZEPHYR_LVGL_MODULE
	bool
	default y
endmenu
menu "mbedtls (/home/mirafra/Girish/GITHUB/Zephyr_Workspace/zephyrproject/modules/crypto/mbedtls)"
osource "$(ZEPHYR_MBEDTLS_KCONFIG)"
config ZEPHYR_MBEDTLS_MODULE
	bool
	default y
endmenu
config ZEPHYR_MCUBOOT_MODULE
	bool
	default y
config ZEPHYR_MIPI_SYS_T_MODULE
	bool
	default y
config ZEPHYR_MLDSA_NATIVE_MODULE
	bool
	default y
menu "nanopb (/home/mirafra/Girish/GITHUB/Zephyr_Workspace/zephyrproject/modules/lib/nanopb)"
osource "$(ZEPHYR_NANOPB_KCONFIG)"
config ZEPHYR_NANOPB_MODULE
	bool
	default y
endmenu
menu "nrf_wifi (/home/mirafra/Girish/GITHUB/Zephyr_Workspace/zephyrproject/modules/lib/nrf_wifi)"
osource "$(ZEPHYR_NRF_WIFI_KCONFIG)"
config ZEPHYR_NRF_WIFI_MODULE
	bool
	default y

config ZEPHYR_NRF_WIFI_MODULE_BLOBS
	bool
endmenu
config ZEPHYR_OPEN_AMP_MODULE
	bool
	default y
menu "openthread (/home/mirafra/Girish/GITHUB/Zephyr_Workspace/zephyrproject/modules/lib/openthread)"
osource "$(ZEPHYR_OPENTHREAD_KCONFIG)"
config ZEPHYR_OPENTHREAD_MODULE
	bool
	default y
endmenu
menu "percepio (/home/mirafra/Girish/GITHUB/Zephyr_Workspace/zephyrproject/modules/debug/percepio)"
osource "/home/mirafra/Girish/GITHUB/Zephyr_Workspace/zephyrproject/modules/debug/percepio/zephyr/Kconfig"
config ZEPHYR_PERCEPIO_MODULE
	bool
	default y
endmenu
menu "picolibc (/home/mirafra/Girish/GITHUB/Zephyr_Workspace/zephyrproject/modules/lib/picolibc)"
osource "/home/mirafra/Girish/GITHUB/Zephyr_Workspace/zephyrproject/modules/lib/picolibc/zephyr/Kconfig"
config ZEPHYR_PICOLIBC_MODULE
	bool
	default y
endmenu
config ZEPHYR_PSA_ARCH_TESTS_MODULE
	bool
	default y
config ZEPHYR_REQMGMT_MODULE
	bool
	default y
menu "segger (/home/mirafra/Girish/GITHUB/Zephyr_Workspace/zephyrproject/modules/debug/segger)"
osource "$(ZEPHYR_SEGGER_KCONFIG)"
config ZEPHYR_SEGGER_MODULE
	bool
	default y
endmenu
config ZEPHYR_TF_M_TESTS_MODULE
	bool
	default y
config ZEPHYR_TF_PSA_CRYPTO_MODULE
	bool
	default y
config ZEPHYR_TF_PSA_CRYPTO_DRIVERS_MODULE
	bool
	default y
menu "trusted-firmware-a (/home/mirafra/Girish/GITHUB/Zephyr_Workspace/zephyrproject/modules/tee/tf-a/trusted-firmware-a)"
osource "$(ZEPHYR_TRUSTED_FIRMWARE_A_KCONFIG)"
config ZEPHYR_TRUSTED_FIRMWARE_A_MODULE
	bool
	default y
endmenu
menu "trusted-firmware-m (/home/mirafra/Girish/GITHUB/Zephyr_Workspace/zephyrproject/modules/tee/tf-m/trusted-firmware-m)"
osource "$(ZEPHYR_TRUSTED_FIRMWARE_M_KCONFIG)"
config ZEPHYR_TRUSTED_FIRMWARE_M_MODULE
	bool
	default y
endmenu
menu "uoscore-uedhoc (/home/mirafra/Girish/GITHUB/Zephyr_Workspace/zephyrproject/modules/lib/uoscore-uedhoc)"
osource "$(ZEPHYR_UOSCORE_UEDHOC_KCONFIG)"
config ZEPHYR_UOSCORE_UEDHOC_MODULE
	bool
	default y
endmenu
menu "zcbor (/home/mirafra/Girish/GITHUB/Zephyr_Workspace/zephyrproject/modules/lib/zcbor)"
osource "$(ZEPHYR_ZCBOR_KCONFIG)"
config ZEPHYR_ZCBOR_MODULE
	bool
	default y
endmenu
menu "xenlib (/home/mirafra/Girish/GITHUB/Zephyr_Workspace/zephyrproject/modules/lib/zephyr-xenlib)"
osource "/home/mirafra/Girish/GITHUB/Zephyr_Workspace/zephyrproject/modules/lib/zephyr-xenlib/Kconfig"
config ZEPHYR_XENLIB_MODULE
	bool
	default y
endmenu
config ZEPHYR_NRF_HW_MODELS_MODULE
	bool
	default y
```

## twister-out/native_sim_native/host_gnu/zephyr-course-stm32-c562re/tests/ring_buf/homework.unit.ring_buf/Kconfig/arch/Kconfig
```kconfig
# Load Zephyr Arch Kconfig descriptions.
osource "/home/mirafra/Girish/GITHUB/Zephyr_Workspace/zephyrproject/zephyr/arch/tricore/Kconfig"
osource "/home/mirafra/Girish/GITHUB/Zephyr_Workspace/zephyrproject/zephyr/arch/hexagon/Kconfig"
osource "/home/mirafra/Girish/GITHUB/Zephyr_Workspace/zephyrproject/zephyr/arch/rx/Kconfig"
osource "/home/mirafra/Girish/GITHUB/Zephyr_Workspace/zephyrproject/zephyr/arch/x86/Kconfig"
osource "/home/mirafra/Girish/GITHUB/Zephyr_Workspace/zephyrproject/zephyr/arch/xtensa/Kconfig"
osource "/home/mirafra/Girish/GITHUB/Zephyr_Workspace/zephyrproject/zephyr/arch/sparc/Kconfig"
osource "/home/mirafra/Girish/GITHUB/Zephyr_Workspace/zephyrproject/zephyr/arch/riscv/Kconfig"
osource "/home/mirafra/Girish/GITHUB/Zephyr_Workspace/zephyrproject/zephyr/arch/posix/Kconfig"
osource "/home/mirafra/Girish/GITHUB/Zephyr_Workspace/zephyrproject/zephyr/arch/openrisc/Kconfig"
osource "/home/mirafra/Girish/GITHUB/Zephyr_Workspace/zephyrproject/zephyr/arch/mips/Kconfig"
osource "/home/mirafra/Girish/GITHUB/Zephyr_Workspace/zephyrproject/zephyr/arch/arm64/Kconfig"
osource "/home/mirafra/Girish/GITHUB/Zephyr_Workspace/zephyrproject/zephyr/arch/arm/Kconfig"
osource "/home/mirafra/Girish/GITHUB/Zephyr_Workspace/zephyrproject/zephyr/arch/arc/Kconfig"
```

## twister-out/native_sim_native/host_gnu/zephyr-course-stm32-c562re/tests/ring_buf/homework.unit.ring_buf/Kconfig/boards/Kconfig
```kconfig
# Load Zephyr board Kconfig descriptions.
osource "/home/mirafra/Girish/GITHUB/Zephyr_Workspace/zephyrproject/zephyr/boards/native/native_sim/Kconfig"
```

## twister-out/native_sim_native/host_gnu/zephyr-course-stm32-c562re/tests/ring_buf/homework.unit.ring_buf/Kconfig/boards/Kconfig.defconfig
```kconfig
# Load Zephyr board defconfig descriptions.
osource "/home/mirafra/Girish/GITHUB/Zephyr_Workspace/zephyrproject/zephyr/boards/native/native_sim/Kconfig.defconfig"
```

## twister-out/native_sim_native/host_gnu/zephyr-course-stm32-c562re/tests/ring_buf/homework.unit.ring_buf/Kconfig/boards/Kconfig.native_sim
```kconfig
# Load board Kconfig descriptions.
osource "/home/mirafra/Girish/GITHUB/Zephyr_Workspace/zephyrproject/zephyr/boards/native/native_sim/Kconfig.native_sim"
```

## twister-out/native_sim_native/host_gnu/zephyr-course-stm32-c562re/tests/ring_buf/homework.unit.ring_buf/Kconfig/boards/Kconfig.sysbuild
```kconfig
# Load Sysbuild board Kconfig descriptions.
osource "/home/mirafra/Girish/GITHUB/Zephyr_Workspace/zephyrproject/zephyr/boards/native/native_sim/Kconfig.sysbuild"
```
