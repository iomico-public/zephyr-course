## twister-out/native_sim_native/host_gnu/zephyr-course-stm32-c562re/tests/ring_buf/homework.unit.ring_buf/Kconfig/soc/Kconfig.defconfig
```kconfig
# Load Zephyr SoC defconfig descriptions.
osource "/home/mirafra/Girish/GITHUB/Zephyr_Workspace/zephyrproject/zephyr/soc/xlnx/zynqmp/Kconfig.defconfig"
osource "/home/mirafra/Girish/GITHUB/Zephyr_Workspace/zephyrproject/zephyr/soc/xlnx/zynq7000/Kconfig.defconfig"
osource "/home/mirafra/Girish/GITHUB/Zephyr_Workspace/zephyrproject/zephyr/soc/xlnx/versalnet/Kconfig.defconfig"
osource "/home/mirafra/Girish/GITHUB/Zephyr_Workspace/zephyrproject/zephyr/soc/xlnx/versal2/Kconfig.defconfig"
osource "/home/mirafra/Girish/GITHUB/Zephyr_Workspace/zephyrproject/zephyr/soc/xlnx/versal/Kconfig.defconfig"
osource "/home/mirafra/Girish/GITHUB/Zephyr_Workspace/zephyrproject/zephyr/soc/xen/Kconfig.defconfig"
osource "/home/mirafra/Girish/GITHUB/Zephyr_Workspace/zephyrproject/zephyr/soc/wch/ch32v/Kconfig.defconfig"
osource "/home/mirafra/Girish/GITHUB/Zephyr_Workspace/zephyrproject/zephyr/soc/ti/tiva_c/Kconfig.defconfig"
osource "/home/mirafra/Girish/GITHUB/Zephyr_Workspace/zephyrproject/zephyr/soc/ti/simplelink/Kconfig.defconfig"
osource "/home/mirafra/Girish/GITHUB/Zephyr_Workspace/zephyrproject/zephyr/soc/ti/mspm/Kconfig.defconfig"
osource "/home/mirafra/Girish/GITHUB/Zephyr_Workspace/zephyrproject/zephyr/soc/ti/lm3s6965/Kconfig.defconfig"
osource "/home/mirafra/Girish/GITHUB/Zephyr_Workspace/zephyrproject/zephyr/soc/ti/k3/Kconfig.defconfig"
osource "/home/mirafra/Girish/GITHUB/Zephyr_Workspace/zephyrproject/zephyr/soc/ti/am13/Kconfig.defconfig"
osource "/home/mirafra/Girish/GITHUB/Zephyr_Workspace/zephyrproject/zephyr/soc/telink/tlsr/Kconfig.defconfig"
osource "/home/mirafra/Girish/GITHUB/Zephyr_Workspace/zephyrproject/zephyr/soc/syna/sr100/Kconfig.defconfig"
osource "/home/mirafra/Girish/GITHUB/Zephyr_Workspace/zephyrproject/zephyr/soc/starfive/jh71xx/Kconfig.defconfig"
osource "/home/mirafra/Girish/GITHUB/Zephyr_Workspace/zephyrproject/zephyr/soc/st/stm32/Kconfig.defconfig"
osource "/home/mirafra/Girish/GITHUB/Zephyr_Workspace/zephyrproject/zephyr/soc/snps/qemu_arc/Kconfig.defconfig"
osource "/home/mirafra/Girish/GITHUB/Zephyr_Workspace/zephyrproject/zephyr/soc/snps/nsim/arc_v/Kconfig.defconfig"
osource "/home/mirafra/Girish/GITHUB/Zephyr_Workspace/zephyrproject/zephyr/soc/snps/nsim/arc_classic/Kconfig.defconfig"
osource "/home/mirafra/Girish/GITHUB/Zephyr_Workspace/zephyrproject/zephyr/soc/snps/hsdk4xd/Kconfig.defconfig"
osource "/home/mirafra/Girish/GITHUB/Zephyr_Workspace/zephyrproject/zephyr/soc/snps/hsdk/Kconfig.defconfig"
osource "/home/mirafra/Girish/GITHUB/Zephyr_Workspace/zephyrproject/zephyr/soc/snps/emsk/Kconfig.defconfig"
osource "/home/mirafra/Girish/GITHUB/Zephyr_Workspace/zephyrproject/zephyr/soc/snps/emsdp/Kconfig.defconfig"
osource "/home/mirafra/Girish/GITHUB/Zephyr_Workspace/zephyrproject/zephyr/soc/snps/arc_iot/Kconfig.defconfig"
osource "/home/mirafra/Girish/GITHUB/Zephyr_Workspace/zephyrproject/zephyr/soc/silabs/Kconfig.defconfig"
osource "/home/mirafra/Girish/GITHUB/Zephyr_Workspace/zephyrproject/zephyr/soc/sifli/sf32/Kconfig.defconfig"
osource "/home/mirafra/Girish/GITHUB/Zephyr_Workspace/zephyrproject/zephyr/soc/sifive/sifive_freedom/Kconfig.defconfig"
osource "/home/mirafra/Girish/GITHUB/Zephyr_Workspace/zephyrproject/zephyr/soc/shakti/Kconfig.defconfig"
osource "/home/mirafra/Girish/GITHUB/Zephyr_Workspace/zephyrproject/zephyr/soc/sensry/Kconfig.defconfig"
osource "/home/mirafra/Girish/GITHUB/Zephyr_Workspace/zephyrproject/zephyr/soc/rockchip/Kconfig.defconfig"
osource "/home/mirafra/Girish/GITHUB/Zephyr_Workspace/zephyrproject/zephyr/soc/renode/riscv_virtual/Kconfig.defconfig"
osource "/home/mirafra/Girish/GITHUB/Zephyr_Workspace/zephyrproject/zephyr/soc/renode/cortex_r8_virtual/Kconfig.defconfig"
osource "/home/mirafra/Girish/GITHUB/Zephyr_Workspace/zephyrproject/zephyr/soc/renesas/smartbond/Kconfig.defconfig"
osource "/home/mirafra/Girish/GITHUB/Zephyr_Workspace/zephyrproject/zephyr/soc/renesas/rz/Kconfig.defconfig"
osource "/home/mirafra/Girish/GITHUB/Zephyr_Workspace/zephyrproject/zephyr/soc/renesas/rx/Kconfig.defconfig"
osource "/home/mirafra/Girish/GITHUB/Zephyr_Workspace/zephyrproject/zephyr/soc/renesas/rcar/Kconfig.defconfig"
osource "/home/mirafra/Girish/GITHUB/Zephyr_Workspace/zephyrproject/zephyr/soc/renesas/ra/Kconfig.defconfig"
osource "/home/mirafra/Girish/GITHUB/Zephyr_Workspace/zephyrproject/zephyr/soc/realtek/fingerprint/Kconfig.defconfig"
osource "/home/mirafra/Girish/GITHUB/Zephyr_Workspace/zephyrproject/zephyr/soc/realtek/ec/Kconfig.defconfig"
osource "/home/mirafra/Girish/GITHUB/Zephyr_Workspace/zephyrproject/zephyr/soc/realtek/bee/Kconfig.defconfig"
osource "/home/mirafra/Girish/GITHUB/Zephyr_Workspace/zephyrproject/zephyr/soc/realtek/ameba/Kconfig.defconfig"
osource "/home/mirafra/Girish/GITHUB/Zephyr_Workspace/zephyrproject/zephyr/soc/raspberrypi/rpi_pico/Kconfig.defconfig"
osource "/home/mirafra/Girish/GITHUB/Zephyr_Workspace/zephyrproject/zephyr/soc/quicklogic/eos_s3/Kconfig.defconfig"
osource "/home/mirafra/Girish/GITHUB/Zephyr_Workspace/zephyrproject/zephyr/soc/qemu/virt_riscv/Kconfig.defconfig"
osource "/home/mirafra/Girish/GITHUB/Zephyr_Workspace/zephyrproject/zephyr/soc/qemu/tricore/Kconfig.defconfig"
osource "/home/mirafra/Girish/GITHUB/Zephyr_Workspace/zephyrproject/zephyr/soc/qemu/or1k/Kconfig.defconfig"
osource "/home/mirafra/Girish/GITHUB/Zephyr_Workspace/zephyrproject/zephyr/soc/qemu/malta/Kconfig.defconfig"
osource "/home/mirafra/Girish/GITHUB/Zephyr_Workspace/zephyrproject/zephyr/soc/qemu/hexagon/Kconfig.defconfig"
osource "/home/mirafra/Girish/GITHUB/Zephyr_Workspace/zephyrproject/zephyr/soc/openisa/rv32m1/Kconfig.defconfig"
osource "/home/mirafra/Girish/GITHUB/Zephyr_Workspace/zephyrproject/zephyr/soc/openhwgroup/erbium/Kconfig.defconfig"
osource "/home/mirafra/Girish/GITHUB/Zephyr_Workspace/zephyrproject/zephyr/soc/openhwgroup/cva6/Kconfig.defconfig"
osource "/home/mirafra/Girish/GITHUB/Zephyr_Workspace/zephyrproject/zephyr/soc/oct/osd32mp15x/Kconfig.defconfig"
osource "/home/mirafra/Girish/GITHUB/Zephyr_Workspace/zephyrproject/zephyr/soc/nxp/s32/Kconfig.defconfig"
osource "/home/mirafra/Girish/GITHUB/Zephyr_Workspace/zephyrproject/zephyr/soc/nxp/rw/Kconfig.defconfig"
osource "/home/mirafra/Girish/GITHUB/Zephyr_Workspace/zephyrproject/zephyr/soc/nxp/mcx/Kconfig.defconfig"
osource "/home/mirafra/Girish/GITHUB/Zephyr_Workspace/zephyrproject/zephyr/soc/nxp/lpc/Kconfig.defconfig"
osource "/home/mirafra/Girish/GITHUB/Zephyr_Workspace/zephyrproject/zephyr/soc/nxp/layerscape/Kconfig.defconfig"
osource "/home/mirafra/Girish/GITHUB/Zephyr_Workspace/zephyrproject/zephyr/soc/nxp/kinetis/Kconfig.defconfig"
osource "/home/mirafra/Girish/GITHUB/Zephyr_Workspace/zephyrproject/zephyr/soc/nxp/imxrt/Kconfig.defconfig"
osource "/home/mirafra/Girish/GITHUB/Zephyr_Workspace/zephyrproject/zephyr/soc/nxp/imx/Kconfig.defconfig"
osource "/home/mirafra/Girish/GITHUB/Zephyr_Workspace/zephyrproject/zephyr/soc/nuvoton/numicro/Kconfig.defconfig"
osource "/home/mirafra/Girish/GITHUB/Zephyr_Workspace/zephyrproject/zephyr/soc/nuvoton/numaker/Kconfig.defconfig"
osource "/home/mirafra/Girish/GITHUB/Zephyr_Workspace/zephyrproject/zephyr/soc/nuvoton/npcx/Kconfig.defconfig"
osource "/home/mirafra/Girish/GITHUB/Zephyr_Workspace/zephyrproject/zephyr/soc/nuvoton/npcm/Kconfig.defconfig"
osource "/home/mirafra/Girish/GITHUB/Zephyr_Workspace/zephyrproject/zephyr/soc/nordic/Kconfig.defconfig"
osource "/home/mirafra/Girish/GITHUB/Zephyr_Workspace/zephyrproject/zephyr/soc/neorv32/Kconfig.defconfig"
osource "/home/mirafra/Girish/GITHUB/Zephyr_Workspace/zephyrproject/zephyr/soc/native/inf_clock/Kconfig.defconfig"
osource "/home/mirafra/Girish/GITHUB/Zephyr_Workspace/zephyrproject/zephyr/soc/microchip/smartfusion2/Kconfig.defconfig"
osource "/home/mirafra/Girish/GITHUB/Zephyr_Workspace/zephyrproject/zephyr/soc/microchip/sam/sama7/Kconfig.defconfig"
osource "/home/mirafra/Girish/GITHUB/Zephyr_Workspace/zephyrproject/zephyr/soc/microchip/sam/sama5/Kconfig.defconfig"
osource "/home/mirafra/Girish/GITHUB/Zephyr_Workspace/zephyrproject/zephyr/soc/microchip/sam/sam_d5x_e5x/Kconfig.defconfig"
osource "/home/mirafra/Girish/GITHUB/Zephyr_Workspace/zephyrproject/zephyr/soc/microchip/polarfire/Kconfig.defconfig"
osource "/home/mirafra/Girish/GITHUB/Zephyr_Workspace/zephyrproject/zephyr/soc/microchip/pic64/Kconfig.defconfig"
osource "/home/mirafra/Girish/GITHUB/Zephyr_Workspace/zephyrproject/zephyr/soc/microchip/pic32c/pic32cz_ca/Kconfig.defconfig"
osource "/home/mirafra/Girish/GITHUB/Zephyr_Workspace/zephyrproject/zephyr/soc/microchip/pic32c/pic32cx_sg/Kconfig.defconfig"
osource "/home/mirafra/Girish/GITHUB/Zephyr_Workspace/zephyrproject/zephyr/soc/microchip/pic32c/pic32cm_sg_gc/Kconfig.defconfig"
osource "/home/mirafra/Girish/GITHUB/Zephyr_Workspace/zephyrproject/zephyr/soc/microchip/pic32c/pic32cm_pl/Kconfig.defconfig"
osource "/home/mirafra/Girish/GITHUB/Zephyr_Workspace/zephyrproject/zephyr/soc/microchip/pic32c/pic32cm_jh/Kconfig.defconfig"
osource "/home/mirafra/Girish/GITHUB/Zephyr_Workspace/zephyrproject/zephyr/soc/microchip/pic32c/pic32ck_sg_gc/Kconfig.defconfig"
osource "/home/mirafra/Girish/GITHUB/Zephyr_Workspace/zephyrproject/zephyr/soc/microchip/miv/Kconfig.defconfig"
osource "/home/mirafra/Girish/GITHUB/Zephyr_Workspace/zephyrproject/zephyr/soc/microchip/mec/Kconfig.defconfig"
osource "/home/mirafra/Girish/GITHUB/Zephyr_Workspace/zephyrproject/zephyr/soc/mediatek/mt8xxx/Kconfig.defconfig"
osource "/home/mirafra/Girish/GITHUB/Zephyr_Workspace/zephyrproject/zephyr/soc/lowrisc/opentitan/Kconfig.defconfig"
osource "/home/mirafra/Girish/GITHUB/Zephyr_Workspace/zephyrproject/zephyr/soc/litex/Kconfig.defconfig"
osource "/home/mirafra/Girish/GITHUB/Zephyr_Workspace/zephyrproject/zephyr/soc/ite/ec/Kconfig.defconfig"
osource "/home/mirafra/Girish/GITHUB/Zephyr_Workspace/zephyrproject/zephyr/soc/intel/wildcat_lake/Kconfig.defconfig"
osource "/home/mirafra/Girish/GITHUB/Zephyr_Workspace/zephyrproject/zephyr/soc/intel/raptor_lake/Kconfig.defconfig"
osource "/home/mirafra/Girish/GITHUB/Zephyr_Workspace/zephyrproject/zephyr/soc/intel/panther_lake/Kconfig.defconfig"
osource "/home/mirafra/Girish/GITHUB/Zephyr_Workspace/zephyrproject/zephyr/soc/intel/nova_lake/Kconfig.defconfig"
osource "/home/mirafra/Girish/GITHUB/Zephyr_Workspace/zephyrproject/zephyr/soc/intel/lakemont/Kconfig.defconfig"
osource "/home/mirafra/Girish/GITHUB/Zephyr_Workspace/zephyrproject/zephyr/soc/intel/intel_socfpga_std/Kconfig.defconfig"
osource "/home/mirafra/Girish/GITHUB/Zephyr_Workspace/zephyrproject/zephyr/soc/intel/intel_socfpga/Kconfig.defconfig"
osource "/home/mirafra/Girish/GITHUB/Zephyr_Workspace/zephyrproject/zephyr/soc/intel/intel_niosv/Kconfig.defconfig"
osource "/home/mirafra/Girish/GITHUB/Zephyr_Workspace/zephyrproject/zephyr/soc/intel/intel_ish/Kconfig.defconfig"
osource "/home/mirafra/Girish/GITHUB/Zephyr_Workspace/zephyrproject/zephyr/soc/intel/intel_adsp/Kconfig.defconfig"
osource "/home/mirafra/Girish/GITHUB/Zephyr_Workspace/zephyrproject/zephyr/soc/intel/elkhart_lake/Kconfig.defconfig"
osource "/home/mirafra/Girish/GITHUB/Zephyr_Workspace/zephyrproject/zephyr/soc/intel/atom/Kconfig.defconfig"
osource "/home/mirafra/Girish/GITHUB/Zephyr_Workspace/zephyrproject/zephyr/soc/intel/apollo_lake/Kconfig.defconfig"
osource "/home/mirafra/Girish/GITHUB/Zephyr_Workspace/zephyrproject/zephyr/soc/intel/alder_lake/Kconfig.defconfig"
osource "/home/mirafra/Girish/GITHUB/Zephyr_Workspace/zephyrproject/zephyr/soc/infineon/psoc4/Kconfig.defconfig"
osource "/home/mirafra/Girish/GITHUB/Zephyr_Workspace/zephyrproject/zephyr/soc/infineon/edge/Kconfig.defconfig"
osource "/home/mirafra/Girish/GITHUB/Zephyr_Workspace/zephyrproject/zephyr/soc/infineon/cat3/Kconfig.defconfig"
osource "/home/mirafra/Girish/GITHUB/Zephyr_Workspace/zephyrproject/zephyr/soc/infineon/cat1c/Kconfig.defconfig"
osource "/home/mirafra/Girish/GITHUB/Zephyr_Workspace/zephyrproject/zephyr/soc/infineon/cat1b/Kconfig.defconfig"
osource "/home/mirafra/Girish/GITHUB/Zephyr_Workspace/zephyrproject/zephyr/soc/infineon/cat1a/Kconfig.defconfig"
osource "/home/mirafra/Girish/GITHUB/Zephyr_Workspace/zephyrproject/zephyr/soc/gd/gd32/Kconfig.defconfig"
osource "/home/mirafra/Girish/GITHUB/Zephyr_Workspace/zephyrproject/zephyr/soc/gaisler/leon3/Kconfig.defconfig"
osource "/home/mirafra/Girish/GITHUB/Zephyr_Workspace/zephyrproject/zephyr/soc/gaisler/gr716a/Kconfig.defconfig"
osource "/home/mirafra/Girish/GITHUB/Zephyr_Workspace/zephyrproject/zephyr/soc/focaltech/Kconfig.defconfig"
osource "/home/mirafra/Girish/GITHUB/Zephyr_Workspace/zephyrproject/zephyr/soc/espressif/Kconfig.defconfig"
osource "/home/mirafra/Girish/GITHUB/Zephyr_Workspace/zephyrproject/zephyr/soc/ene/kb1200/Kconfig.defconfig"
osource "/home/mirafra/Girish/GITHUB/Zephyr_Workspace/zephyrproject/zephyr/soc/ene/kb106x/Kconfig.defconfig"
osource "/home/mirafra/Girish/GITHUB/Zephyr_Workspace/zephyrproject/zephyr/soc/elan/em32f967/Kconfig.defconfig"
osource "/home/mirafra/Girish/GITHUB/Zephyr_Workspace/zephyrproject/zephyr/soc/egis/Kconfig.defconfig"
osource "/home/mirafra/Girish/GITHUB/Zephyr_Workspace/zephyrproject/zephyr/soc/efinix/sapphire/Kconfig.defconfig"
osource "/home/mirafra/Girish/GITHUB/Zephyr_Workspace/zephyrproject/zephyr/soc/cdns/xtensa_sample_controller/Kconfig.defconfig"
osource "/home/mirafra/Girish/GITHUB/Zephyr_Workspace/zephyrproject/zephyr/soc/cdns/swerv/Kconfig.defconfig"
osource "/home/mirafra/Girish/GITHUB/Zephyr_Workspace/zephyrproject/zephyr/soc/cdns/sample_controller32/Kconfig.defconfig"
osource "/home/mirafra/Girish/GITHUB/Zephyr_Workspace/zephyrproject/zephyr/soc/cdns/dc233c/Kconfig.defconfig"
osource "/home/mirafra/Girish/GITHUB/Zephyr_Workspace/zephyrproject/zephyr/soc/cdac/Kconfig.defconfig"
osource "/home/mirafra/Girish/GITHUB/Zephyr_Workspace/zephyrproject/zephyr/soc/brcm/bcmvk/Kconfig.defconfig"
osource "/home/mirafra/Girish/GITHUB/Zephyr_Workspace/zephyrproject/zephyr/soc/brcm/bcm2712/Kconfig.defconfig"
osource "/home/mirafra/Girish/GITHUB/Zephyr_Workspace/zephyrproject/zephyr/soc/brcm/bcm2711/Kconfig.defconfig"
osource "/home/mirafra/Girish/GITHUB/Zephyr_Workspace/zephyrproject/zephyr/soc/brcm/bcm2710/Kconfig.defconfig"
osource "/home/mirafra/Girish/GITHUB/Zephyr_Workspace/zephyrproject/zephyr/soc/blackberry/qnxhv_vm/Kconfig.defconfig"
osource "/home/mirafra/Girish/GITHUB/Zephyr_Workspace/zephyrproject/zephyr/soc/bflb/Kconfig.defconfig"
osource "/home/mirafra/Girish/GITHUB/Zephyr_Workspace/zephyrproject/zephyr/soc/atmel/sam0/Kconfig.defconfig"
osource "/home/mirafra/Girish/GITHUB/Zephyr_Workspace/zephyrproject/zephyr/soc/atmel/sam/Kconfig.defconfig"
osource "/home/mirafra/Girish/GITHUB/Zephyr_Workspace/zephyrproject/zephyr/soc/aspeed/Kconfig.defconfig"
osource "/home/mirafra/Girish/GITHUB/Zephyr_Workspace/zephyrproject/zephyr/soc/arm/Kconfig.defconfig"
osource "/home/mirafra/Girish/GITHUB/Zephyr_Workspace/zephyrproject/zephyr/soc/antmicro/myra/Kconfig.defconfig"
osource "/home/mirafra/Girish/GITHUB/Zephyr_Workspace/zephyrproject/zephyr/soc/andestech/Kconfig.defconfig"
osource "/home/mirafra/Girish/GITHUB/Zephyr_Workspace/zephyrproject/zephyr/soc/amd/acp_7_x/Kconfig.defconfig"
osource "/home/mirafra/Girish/GITHUB/Zephyr_Workspace/zephyrproject/zephyr/soc/amd/acp_7_0/Kconfig.defconfig"
osource "/home/mirafra/Girish/GITHUB/Zephyr_Workspace/zephyrproject/zephyr/soc/amd/acp_6_0/Kconfig.defconfig"
osource "/home/mirafra/Girish/GITHUB/Zephyr_Workspace/zephyrproject/zephyr/soc/ambiq/Kconfig.defconfig"
osource "/home/mirafra/Girish/GITHUB/Zephyr_Workspace/zephyrproject/zephyr/soc/allwinner/sun8i_h3/Kconfig.defconfig"
osource "/home/mirafra/Girish/GITHUB/Zephyr_Workspace/zephyrproject/zephyr/soc/allwinner/sun50i_h618/Kconfig.defconfig"
osource "/home/mirafra/Girish/GITHUB/Zephyr_Workspace/zephyrproject/zephyr/soc/alif/ensemble/Kconfig.defconfig"
osource "/home/mirafra/Girish/GITHUB/Zephyr_Workspace/zephyrproject/zephyr/soc/alif/balletto/Kconfig.defconfig"
osource "/home/mirafra/Girish/GITHUB/Zephyr_Workspace/zephyrproject/zephyr/soc/aesc/Kconfig.defconfig"
osource "/home/mirafra/Girish/GITHUB/Zephyr_Workspace/zephyrproject/zephyr/soc/adi/max32/Kconfig.defconfig"
```
