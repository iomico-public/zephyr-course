## app/boards/my_board_cp/Kconfig.my_board_cp
```kconfig
# Copyright (c) 2016 BayLibre, SAS
# SPDX-License-Identifier: Apache-2.0

config BOARD_MY_BOARD_CP
    default y
    select SOC_STM32L476XX
```

## app/boards/my_board_cp/board.yml
```yaml
board:
  name: my_board_cp
  full_name: My Custom Board CP
  vendor: st
  socs:
    - name: stm32l476xx
```

## app/boards/my_board_fs/board.yml
```yaml
board:
  name: my_board_fs
  full_name: My Board From Scratch
  vendor: st
  socs:
    - name: stm32l476xx
```

## app/build_my_board_cp/Kconfig/Kconfig.shield
```kconfig
osource "C:/Users/danil/zephyrproject/zephyr-course/app/boards/shields/*/Kconfig.shield"
```

## app/build_my_board_cp/Kconfig/boards/Kconfig
```kconfig
# Load Zephyr board Kconfig descriptions.
osource "C:/Users/danil/zephyrproject/zephyr-course/app/boards/my_board_cp/Kconfig"
```

## app/build_my_board_cp/Kconfig/boards/Kconfig.defconfig
```kconfig
# Load Zephyr board defconfig descriptions.
osource "C:/Users/danil/zephyrproject/zephyr-course/app/boards/my_board_cp/Kconfig.defconfig"
```

## app/build_my_board_cp/Kconfig/soc/Kconfig
```kconfig
# Load Zephyr SoC Kconfig descriptions.
osource "C:/Users/danil/zephyrproject/zephyr/soc/xlnx/zynqmp/Kconfig"
osource "C:/Users/danil/zephyrproject/zephyr/soc/xlnx/zynq7000/Kconfig"
osource "C:/Users/danil/zephyrproject/zephyr/soc/xlnx/versalnet/Kconfig"
osource "C:/Users/danil/zephyrproject/zephyr/soc/xlnx/versal2/Kconfig"
osource "C:/Users/danil/zephyrproject/zephyr/soc/xlnx/versal/Kconfig"
osource "C:/Users/danil/zephyrproject/zephyr/soc/xen/Kconfig"
osource "C:/Users/danil/zephyrproject/zephyr/soc/wch/ch32v/Kconfig"
osource "C:/Users/danil/zephyrproject/zephyr/soc/ti/simplelink/Kconfig"
osource "C:/Users/danil/zephyrproject/zephyr/soc/ti/mspm0/Kconfig"
osource "C:/Users/danil/zephyrproject/zephyr/soc/ti/lm3s6965/Kconfig"
osource "C:/Users/danil/zephyrproject/zephyr/soc/ti/k3/Kconfig"
osource "C:/Users/danil/zephyrproject/zephyr/soc/telink/tlsr/Kconfig"
osource "C:/Users/danil/zephyrproject/zephyr/soc/starfive/jh71xx/Kconfig"
osource "C:/Users/danil/zephyrproject/zephyr/soc/st/stm32/Kconfig"
osource "C:/Users/danil/zephyrproject/zephyr/soc/snps/qemu_arc/Kconfig"
osource "C:/Users/danil/zephyrproject/zephyr/soc/snps/nsim/arc_v/Kconfig"
osource "C:/Users/danil/zephyrproject/zephyr/soc/snps/nsim/arc_classic/Kconfig"
osource "C:/Users/danil/zephyrproject/zephyr/soc/snps/hsdk4xd/Kconfig"
osource "C:/Users/danil/zephyrproject/zephyr/soc/snps/hsdk/Kconfig"
osource "C:/Users/danil/zephyrproject/zephyr/soc/snps/emsk/Kconfig"
osource "C:/Users/danil/zephyrproject/zephyr/soc/snps/emsdp/Kconfig"
osource "C:/Users/danil/zephyrproject/zephyr/soc/snps/arc_iot/Kconfig"
osource "C:/Users/danil/zephyrproject/zephyr/soc/silabs/Kconfig"
osource "C:/Users/danil/zephyrproject/zephyr/soc/sifli/sf32/Kconfig"
osource "C:/Users/danil/zephyrproject/zephyr/soc/sifive/sifive_freedom/Kconfig"
osource "C:/Users/danil/zephyrproject/zephyr/soc/sensry/Kconfig"
osource "C:/Users/danil/zephyrproject/zephyr/soc/rockchip/Kconfig"
osource "C:/Users/danil/zephyrproject/zephyr/soc/renode/riscv_virtual/Kconfig"
osource "C:/Users/danil/zephyrproject/zephyr/soc/renode/cortex_r8_virtual/Kconfig"
osource "C:/Users/danil/zephyrproject/zephyr/soc/renesas/smartbond/Kconfig"
osource "C:/Users/danil/zephyrproject/zephyr/soc/renesas/rz/Kconfig"
osource "C:/Users/danil/zephyrproject/zephyr/soc/renesas/rx/Kconfig"
osource "C:/Users/danil/zephyrproject/zephyr/soc/renesas/rcar/Kconfig"
osource "C:/Users/danil/zephyrproject/zephyr/soc/renesas/ra/Kconfig"
osource "C:/Users/danil/zephyrproject/zephyr/soc/realtek/fingerprint/Kconfig"
osource "C:/Users/danil/zephyrproject/zephyr/soc/realtek/ec/Kconfig"
osource "C:/Users/danil/zephyrproject/zephyr/soc/realtek/bee/Kconfig"
osource "C:/Users/danil/zephyrproject/zephyr/soc/realtek/ameba/Kconfig"
osource "C:/Users/danil/zephyrproject/zephyr/soc/raspberrypi/rpi_pico/Kconfig"
osource "C:/Users/danil/zephyrproject/zephyr/soc/quicklogic/eos_s3/Kconfig"
osource "C:/Users/danil/zephyrproject/zephyr/soc/qemu/virt_riscv/Kconfig"
osource "C:/Users/danil/zephyrproject/zephyr/soc/qemu/malta/Kconfig"
osource "C:/Users/danil/zephyrproject/zephyr/soc/openisa/rv32m1/Kconfig"
osource "C:/Users/danil/zephyrproject/zephyr/soc/openhwgroup/cva6/Kconfig"
osource "C:/Users/danil/zephyrproject/zephyr/soc/oct/osd32mp15x/Kconfig"
osource "C:/Users/danil/zephyrproject/zephyr/soc/nxp/s32/Kconfig"
osource "C:/Users/danil/zephyrproject/zephyr/soc/nxp/rw/Kconfig"
osource "C:/Users/danil/zephyrproject/zephyr/soc/nxp/mcx/Kconfig"
osource "C:/Users/danil/zephyrproject/zephyr/soc/nxp/lpc/Kconfig"
osource "C:/Users/danil/zephyrproject/zephyr/soc/nxp/layerscape/Kconfig"
osource "C:/Users/danil/zephyrproject/zephyr/soc/nxp/kinetis/Kconfig"
osource "C:/Users/danil/zephyrproject/zephyr/soc/nxp/imxrt/Kconfig"
osource "C:/Users/danil/zephyrproject/zephyr/soc/nxp/imx/Kconfig"
osource "C:/Users/danil/zephyrproject/zephyr/soc/nuvoton/numicro/Kconfig"
osource "C:/Users/danil/zephyrproject/zephyr/soc/nuvoton/numaker/Kconfig"
osource "C:/Users/danil/zephyrproject/zephyr/soc/nuvoton/npcx/Kconfig"
osource "C:/Users/danil/zephyrproject/zephyr/soc/nuvoton/npcm/Kconfig"
osource "C:/Users/danil/zephyrproject/zephyr/soc/nordic/Kconfig"
osource "C:/Users/danil/zephyrproject/zephyr/soc/neorv32/Kconfig"
osource "C:/Users/danil/zephyrproject/zephyr/soc/native/inf_clock/Kconfig"
osource "C:/Users/danil/zephyrproject/zephyr/soc/microchip/sam/sama7/Kconfig"
osource "C:/Users/danil/zephyrproject/zephyr/soc/microchip/sam/sam_d5x_e5x/Kconfig"
osource "C:/Users/danil/zephyrproject/zephyr/soc/microchip/pic64/Kconfig"
osource "C:/Users/danil/zephyrproject/zephyr/soc/microchip/pic32c/pic32cz_ca/Kconfig"
osource "C:/Users/danil/zephyrproject/zephyr/soc/microchip/pic32c/pic32cx_sg/Kconfig"
osource "C:/Users/danil/zephyrproject/zephyr/soc/microchip/pic32c/pic32cm_pl/Kconfig"
osource "C:/Users/danil/zephyrproject/zephyr/soc/microchip/pic32c/pic32cm_jh/Kconfig"
osource "C:/Users/danil/zephyrproject/zephyr/soc/microchip/miv/Kconfig"
osource "C:/Users/danil/zephyrproject/zephyr/soc/microchip/mec/Kconfig"
osource "C:/Users/danil/zephyrproject/zephyr/soc/mediatek/mt8xxx/Kconfig"
osource "C:/Users/danil/zephyrproject/zephyr/soc/lowrisc/opentitan/Kconfig"
osource "C:/Users/danil/zephyrproject/zephyr/soc/litex/litex_vexriscv/Kconfig"
osource "C:/Users/danil/zephyrproject/zephyr/soc/ite/ec/Kconfig"
osource "C:/Users/danil/zephyrproject/zephyr/soc/intel/wildcat_lake/Kconfig"
osource "C:/Users/danil/zephyrproject/zephyr/soc/intel/raptor_lake/Kconfig"
osource "C:/Users/danil/zephyrproject/zephyr/soc/intel/panther_lake/Kconfig"
osource "C:/Users/danil/zephyrproject/zephyr/soc/intel/lakemont/Kconfig"
osource "C:/Users/danil/zephyrproject/zephyr/soc/intel/intel_socfpga_std/Kconfig"
osource "C:/Users/danil/zephyrproject/zephyr/soc/intel/intel_socfpga/Kconfig"
osource "C:/Users/danil/zephyrproject/zephyr/soc/intel/intel_niosv/Kconfig"
osource "C:/Users/danil/zephyrproject/zephyr/soc/intel/intel_ish/Kconfig"
osource "C:/Users/danil/zephyrproject/zephyr/soc/intel/intel_adsp/Kconfig"
osource "C:/Users/danil/zephyrproject/zephyr/soc/intel/elkhart_lake/Kconfig"
osource "C:/Users/danil/zephyrproject/zephyr/soc/intel/atom/Kconfig"
osource "C:/Users/danil/zephyrproject/zephyr/soc/intel/apollo_lake/Kconfig"
osource "C:/Users/danil/zephyrproject/zephyr/soc/intel/alder_lake/Kconfig"
osource "C:/Users/danil/zephyrproject/zephyr/soc/infineon/psoc4/Kconfig"
osource "C:/Users/danil/zephyrproject/zephyr/soc/infineon/edge/Kconfig"
osource "C:/Users/danil/zephyrproject/zephyr/soc/infineon/cat3/Kconfig"
osource "C:/Users/danil/zephyrproject/zephyr/soc/infineon/cat1c/Kconfig"
osource "C:/Users/danil/zephyrproject/zephyr/soc/infineon/cat1b/Kconfig"
osource "C:/Users/danil/zephyrproject/zephyr/soc/infineon/cat1a/Kconfig"
osource "C:/Users/danil/zephyrproject/zephyr/soc/gd/gd32/Kconfig"
osource "C:/Users/danil/zephyrproject/zephyr/soc/gaisler/leon3/Kconfig"
osource "C:/Users/danil/zephyrproject/zephyr/soc/gaisler/gr716a/Kconfig"
osource "C:/Users/danil/zephyrproject/zephyr/soc/focaltech/Kconfig"
osource "C:/Users/danil/zephyrproject/zephyr/soc/espressif/Kconfig"
osource "C:/Users/danil/zephyrproject/zephyr/soc/ene/kb1200/Kconfig"
osource "C:/Users/danil/zephyrproject/zephyr/soc/ene/kb106x/Kconfig"
osource "C:/Users/danil/zephyrproject/zephyr/soc/elan/em32f967/Kconfig"
osource "C:/Users/danil/zephyrproject/zephyr/soc/egis/Kconfig"
osource "C:/Users/danil/zephyrproject/zephyr/soc/efinix/sapphire/Kconfig"
osource "C:/Users/danil/zephyrproject/zephyr/soc/cdns/xtensa_sample_controller/Kconfig"
osource "C:/Users/danil/zephyrproject/zephyr/soc/cdns/sample_controller32/Kconfig"
osource "C:/Users/danil/zephyrproject/zephyr/soc/cdns/dc233c/Kconfig"
osource "C:/Users/danil/zephyrproject/zephyr/soc/brcm/bcmvk/Kconfig"
osource "C:/Users/danil/zephyrproject/zephyr/soc/brcm/bcm2712/Kconfig"
osource "C:/Users/danil/zephyrproject/zephyr/soc/brcm/bcm2711/Kconfig"
osource "C:/Users/danil/zephyrproject/zephyr/soc/blackberry/qnxhv_vm/Kconfig"
osource "C:/Users/danil/zephyrproject/zephyr/soc/bflb/Kconfig"
osource "C:/Users/danil/zephyrproject/zephyr/soc/atmel/sam0/Kconfig"
osource "C:/Users/danil/zephyrproject/zephyr/soc/atmel/sam/Kconfig"
osource "C:/Users/danil/zephyrproject/zephyr/soc/aspeed/Kconfig"
osource "C:/Users/danil/zephyrproject/zephyr/soc/arm/Kconfig"
osource "C:/Users/danil/zephyrproject/zephyr/soc/arm/beetle/Kconfig"
osource "C:/Users/danil/zephyrproject/zephyr/soc/antmicro/myra/Kconfig"
osource "C:/Users/danil/zephyrproject/zephyr/soc/andestech/Kconfig"
osource "C:/Users/danil/zephyrproject/zephyr/soc/amd/acp_6_0/Kconfig"
osource "C:/Users/danil/zephyrproject/zephyr/soc/ambiq/Kconfig"
osource "C:/Users/danil/zephyrproject/zephyr/soc/allwinner/sun8i_h3/Kconfig"
osource "C:/Users/danil/zephyrproject/zephyr/soc/alif/ensemble/Kconfig"
osource "C:/Users/danil/zephyrproject/zephyr/soc/aesc/Kconfig"
osource "C:/Users/danil/zephyrproject/zephyr/soc/adi/max32/Kconfig"
```

## app/build_my_board_fs/Kconfig/boards/Kconfig.defconfig
```kconfig
# Load Zephyr board defconfig descriptions.
osource "C:/Users/danil/zephyrproject/zephyr-course/app/boards/my_board_fs/Kconfig.defconfig"
```

## app/build_my_board_fs/Kconfig/boards/Kconfig.my_board_fs
```kconfig
# Load board Kconfig descriptions.
osource "C:/Users/danil/zephyrproject/zephyr-course/app/boards/my_board_fs/Kconfig.my_board_fs"
```

## app/build_my_board_fs/Kconfig/boards/Kconfig.sysbuild.tmp
```kconfig
# Load Sysbuild board Kconfig descriptions.
osource "C:/Users/danil/zephyrproject/zephyr-course/app/boards/my_board_fs/Kconfig.sysbuild"
```

## app/drivers/dts/bindings/sarche_driver.yaml
```yaml
description: LED driver just for fun
compatible: "sarche,driver"
include: base.yaml

properties:
  led-gpios:
    type: phandle-array
    required: true
    description: GPIO pin to control the LED
```

## app/drivers/sarche_driver/Kconfig
```kconfig
config SARCHE_DRIVER
    bool "sarche driver"
    depends on DT_HAS_SARCHE_DRIVER_ENABLED
    default y
```

## app/drivers/sensor/led_sensor/Kconfig
```kconfig
config LED_SENSOR
bool "Simple LED sensor driver"
depends on SENSOR
select GPIO
default y
help
  Simple sensor-style driver that controls an on-board LED.
```

## app/modules/led_sensor_module/drivers/led_sensor/Kconfig
```kconfig
menuconfig LED_SENSOR
    bool "On-board LED Sensor Driver"
    default y
    select GPIO
    help
      Enable the on-board LED sensor driver.
```

## app/modules/led_sensor_module/dts/bindings/led_sensor/iomico,led-sensor.yaml
```yaml
description: On-board LED used as a sensor device

compatible: "iomico,led-sensor"

include: base.yaml

properties:
  gpios:
    type: phandle-array
    required: true
    description: GPIO pin connected to the LED
```

## boards/my_board/Kconfig.defconfig
```kconfig
config HEAP_MEM_POOL_ADD_SIZE_BOARD
	int
	default 4096 if BOARD_MY_BOARD_ESP32C6_HPCORE
	default 256 if BOARD_MY_BOARD_ESP32C6_LPCORE
```

## boards/my_board/Kconfig.my_board
```kconfig
config BOARD_MY_BOARD
	select SOC_ESP32_C6_WROOM_1U_N8
	select SOC_ESP32C6_HPCORE if BOARD_MY_BOARD_ESP32C6_HPCORE
	select SOC_ESP32C6_LPCORE if BOARD_MY_BOARD_ESP32C6_LPCORE
```

## boards/my_board/board.yml
```yaml
board:
  name: my_board
  full_name: My board from scratch
  vendor: mutuma
  socs:
  - name: esp32c6
```

## boards/others/gorral_esp32_copy/Kconfig.gorral_esp32_copy
```kconfig
# Copyright (c) 2023-2025 Espressif Systems (Shanghai) Co., Ltd.
# SPDX-License-Identifier: Apache-2.0

config BOARD_GORRAL_ESP32_COPY
	select SOC_ESP32_WROVER_E_N4R8
	select SOC_ESP32_PROCPU if BOARD_GORRAL_ESP32_COPY_ESP32_PROCPU
	select SOC_ESP32_APPCPU if BOARD_GORRAL_ESP32_COPY_ESP32_APPCPU
```

## boards/others/gorral_esp32_copy/board.yml
```yaml
board:
  name: gorral_esp32_copy
  full_name: Gorral ESP32 Copy
  vendor: espressif
  socs:
  - name: esp32
```

## boards/others/gorral_esp32_scratch/Kconfig
```kconfig
config HEAP_MEM_POOL_ADD_SIZE_BOARD
    int
    default 4096 if BOARD_GORRAL_ESP32_SCRATCH_ESP32_PROCPU
```

## boards/others/gorral_esp32_scratch/Kconfig.gorral_esp32_scratch
```kconfig
config BOARD_GORRAL_ESP32_SCRATCH
    select SOC_ESP32_WROVER_E_N4R8
    select SOC_ESP32_PROCPU if BOARD_GORRAL_ESP32_SCRATCH_ESP32_PROCPU
```

## boards/others/gorral_esp32_scratch/board.yml
```yaml
board:
  name: gorral_esp32_scratch
  full_name: Gorral ESP32 Scratch
  vendor: espressif
  socs:
  - name: esp32
```

## boards/our_board/Kconfig.our_board
```kconfig
# ESP32C6 devkitc board configuration

# Copyright (c) 2024 Espressif Systems (Shanghai) Co., Ltd.
# SPDX-License-Identifier: Apache-2.0

config BOARD_OUR_BOARD
	select SOC_ESP32_C6_WROOM_1U_N8
	select SOC_ESP32C6_HPCORE if BOARD_OUR_BOARD_ESP32C6_HPCORE
	select SOC_ESP32C6_LPCORE if BOARD_OUR_BOARD_ESP32C6_LPCORE
```
