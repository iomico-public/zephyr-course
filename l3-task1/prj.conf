## CMakeLists.txt
```
cmake_minimum_required(VERSION 4.20.0)

find_package(Zephyr REQUIRED HINTS $ENV{ZEPHYR_BASE})
project(l3_task1 LANGUAGES C)

zephyr_library_amend_sysbuild(KCONFIG /home/spamboii/zephyr-course-fundamentals/l3-task1/Kconfig)

target_sources(app PRIVATE src/main.c)
```

## Kconfig
```
# 1. Pull in the base kernel configurations cleanly via relative sourcing
rsource "../../zephyrproject/zephyr/Kconfig.zephyr"

# 2. Append your custom homework hierarchical layout below
menuconfig LED_SUBSYSTEM
    bool "LED Subsystem"
    default y
    help
      Enable custom multi-level LED management features.

if LED_SUBSYSTEM

    choice
        prompt "LED blink sleep time"
        default BLINK_SLEEP_1000MS

    config BLINK_SLEEP_250MS
        bool "Fast (250ms)"

    config BLINK_SLEEP_500MS
        bool "Medium-Fast (500ms)"

    config BLINK_SLEEP_1000MS
        bool "Medium (1s)"

    config BLINK_SLEEP_2000MS
        bool "Slow (2s)"
    endchoice

    config BLINK_SLEEP_TIME_MS
        int
        default 250 if BLINK_SLEEP_250MS
        default 500 if BLINK_SLEEP_500MS
        default 1000 if BLINK_SLEEP_1000MS
        default 2000 if BLINK_SLEEP_2000MS
        default 1000

    menuconfig ADVANCED_LED_SETTINGS
        bool "Advanced LED settings"
        default n

    if ADVANCED_LED_SETTINGS
        config LED_BRIGHTNESS
            int "LED brightness (0-100)"
            range 0 100
            default 100

        config LED_FADE_DURATION_MS
            int "LED fade duration (ms)"
            range 0 5000
            default 500
    endif

    menu "Expert settings"
        visible if ADVANCED_LED_SETTINGS

        config ENABLE_LED_DEBUGGING
            bool "Enable LED debugging"
            default n

        config CUSTOM_BLINK_PATTERN
            bool "Custom blink pattern"
            default n
    endmenu

endif # LED_SUBSYSTEM
```

## prj.conf
```kconfig
CONFIG_GPIO=y

# Keeps your custom hierarchical Kconfig menus active
CONFIG_LED_SUBSYSTEM=y
```

## src/main.c
```c
#include <zephyr/kernel.h>
#include <zephyr/drivers/gpio.h>
#include <zephyr/logging/log.h>

LOG_MODULE_REGISTER(main, LOG_LEVEL_INF);

/* Fallback default definition if menuconfig options are hidden */
#ifndef CONFIG_BLINK_SLEEP_TIME_MS
#define CONFIG_BLINK_SLEEP_TIME_MS 1000
#endif

/* 
 * Target the board's native pre-configured green LED alias directly.
 * No custom app.overlay required!
 */
static const struct gpio_dt_spec led = GPIO_DT_SPEC_GET(DT_ALIAS(led1), gpios);

int main(void)
{
    int ret;
    bool led_state = false;

    // Check if the onboard GPIO controller peripheral is fully online
    if (!gpio_is_ready_dt(&led)) {
        LOG_ERR("Hardware Error: Onboard GPIO controller for led1 is not ready.");
        return -EIO;
    }

    // Configure the target pin as a standard output, initializing it to INACTIVE (off)
    ret = gpio_pin_configure_dt(&led, GPIO_OUTPUT_INACTIVE);
    if (ret < 0) {
        LOG_ERR("Error: Failed to configure LED pin framework (code %d).", ret);
        return ret;
    }

    LOG_INF("Overlay-free GPIO LED blink application initialized on FRDM-MCXN236!");
    LOG_INF("Blink interval synchronized to: %d ms", CONFIG_BLINK_SLEEP_TIME_MS);

    while (1) {
        // Toggle our logic state tracker variable
        led_state = !led_state;
        
        // Drive the physical pin high or low logically
        ret = gpio_pin_set_dt(&led, (int)led_state);
        if (ret < 0) {
            LOG_ERR("GPIO Error: Failed to toggle pin value (code %d).", ret);
            return ret;
        }

        #if IS_ENABLED(CONFIG_ENABLE_LED_DEBUGGING)
            LOG_INF("Debug Flag: LED toggled to state %d.", led_state);
        #endif

        // Apply your custom hierarchical sleep time dynamically from Kconfig
        k_msleep(CONFIG_BLINK_SLEEP_TIME_MS);
    }

    return 0;
}
```
