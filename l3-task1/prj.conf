## CMakeLists.txt
```
cmake_minimum_required(VERSION 3.20.0)

find_package(Zephyr REQUIRED HINTS $ENV{ZEPHYR_BASE})
project(l3-task1)

target_sources(app PRIVATE src/main.c)
```

## Kconfig
```
source "$(ZEPHYR_BASE)/Kconfig.zephyr"

menuconfig LED_SUBSYSTEM
    bool "LED Subsystem"
    default y
    help
      Enable the LED subsystem.

if LED_SUBSYSTEM

choice LED_BLINK_SLEEP_TIME
    prompt "LED blink sleep time"
    default LED_BLINK_SLEEP_TIME_1S
    help
      Select the LED blink interval.

config LED_BLINK_SLEEP_TIME_250MS
    bool "fast (250ms)"

config LED_BLINK_SLEEP_TIME_500MS
    bool "medium-fast (500ms)"

config LED_BLINK_SLEEP_TIME_1S
    bool "medium (1s)"

config LED_BLINK_SLEEP_TIME_2S
    bool "slow (2s)"

endchoice

config LED_BLINK_SLEEP_MS
    int
    default 250 if LED_BLINK_SLEEP_TIME_250MS
    default 500 if LED_BLINK_SLEEP_TIME_500MS
    default 1000 if LED_BLINK_SLEEP_TIME_1S
    default 2000 if LED_BLINK_SLEEP_TIME_2S

menuconfig LED_ADVANCED
    bool "Advanced LED settings"
    default n

if LED_ADVANCED

config LED_BRIGHTNESS
    int "LED brightness (0-100)"
    default 50
    range 0 100

config LED_FADE_DURATION
    int "LED fade duration in milliseconds"
    default 1000

menu "Expert settings"
    visible if LED_ADVANCED

config LED_DEBUG
    bool "Enable LED debugging"
    default n

config LED_CUSTOM_BLINK
    bool "Custom blink pattern"
    default n

endmenu

endif # LED_ADVANCED
endif # LED_SUBSYSTEM
```

## prj.conf
```kconfig
CONFIG_GPIO=y
CONFIG_LOG=y
CONFIG_LOG_MODE_DEFERRED=y
CONFIG_LED_SUBSYSTEM=y
CONFIG_LED_BLINK_SLEEP_TIME_1S=y
CONFIG_LED_ADVANCED=y
CONFIG_LED_BRIGHTNESS=50
CONFIG_LED_FADE_DURATION=1000
```

## src/main.c
```c
#include <zephyr/kernel.h>
#include <zephyr/drivers/gpio.h>
#include <zephyr/logging/log.h>

LOG_MODULE_REGISTER(main, LOG_LEVEL_INF);

#define LED_NODE DT_ALIAS(led0)
static const struct gpio_dt_spec led = GPIO_DT_SPEC_GET(LED_NODE, gpios);

int main(void)
{
    bool led_state = true;

    LOG_INF("LED Subsystem started");
    LOG_INF("Blink interval: %d ms", CONFIG_LED_BLINK_SLEEP_MS);
    LOG_INF("Brightness: %d", CONFIG_LED_BRIGHTNESS);
    LOG_INF("Fade duration: %d ms", CONFIG_LED_FADE_DURATION);

    if (!gpio_is_ready_dt(&led)) return 0;
    if (gpio_pin_configure_dt(&led, GPIO_OUTPUT_ACTIVE) < 0) return 0;

    while (1) {
        if (gpio_pin_toggle_dt(&led) < 0) return 0;
        led_state = !led_state;
        LOG_INF("LED state: %s", led_state ? "ON" : "OFF");
        k_msleep(CONFIG_LED_BLINK_SLEEP_MS);
    }

    return 0;
}
```
